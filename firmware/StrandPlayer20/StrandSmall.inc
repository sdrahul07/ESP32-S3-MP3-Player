static const uint8_t StrandSmallBits[] PROGMEM={
0,93,0,0,4,208,0,0,76,0,0,3,192,0,0,59,0,0,0,0,0,0,93,0,0,5,208,0,7,195,241,0,107,47,0,5,161,224,0,0,0,0,0,0,0,0,0,0,0,0,0,0,0,0,0,0,0,208,164,0,28,11,32,127,255,255,80,73,13,0,6,112,208,11,255,255,240,8,83,160,0,163,89,0,0,9,64,0,92,255,80,46,61,0,3,225,208,0,9,237,32,0,5,222,80,0,103,92,0,8,104,176,95,254,162,0,12,16,0,78,192,12,58,74,71,112,180,167,176,4,235,194,0,0,138,236,16,59,164,149,12,43,73,72,96,78,176,5,238,96,0,228,77,0,13,70,160,0,127,161,0,61,156,46,9,112,172,192,139,19,249,1,190,215,227,0,94,0,0,4,208,0,0,60,0,0,0,0,0,0,0,0,0,0,0,0,0,0,0,0,0,0,0,0,2,160,0,0,196,0,0,121,0,0,13,32,0,2,224,0,0,60,0,0,2,224,0,0,13,48,0,0,122,0,0,0,197,0,0,2,176,0,3,144,0,0,10,112,0,0,30,32,0,0,151,0,0,5,176,0,0,60,0,0,5,176,0,0,151,0,0,29,32,0,10,112,0,3,144,0,0,0,26,0,0,164,168,96,1,191,96,0,165,168,80,0,26,0,0,0,0,0,0,0,0,0,0,0,0,0,60,0,0,3,192,0,143,255,255,32,3,192,0,0,60,0,0,0,0,0,0,125,16,0,5,243,0,0,94,0,0,156,48,0,7,255,241,0,0,0,0,0,0,0,0,0,0,0,0,125,16,0,8,225,0,0,0,135,0,0,29,16,0,6,128,0,0,210,0,0,90,0,0,12,48,0,3,176,0,0,165,0,0,45,0,0,0,3,222,161,0,229,25,144,91,0,174,6,145,183,241,122,198,15,5,245,2,224,29,49,168,0,77,234,0,4,175,32,1,196,242,0,0,15,32,0,0,242,0,0,15,32,0,0,242,0,0,15,32,0,255,255,208,5,222,144,0,178,45,80,0,0,167,0,0,29,48,0,10,144,0,9,160,0,9,160,0,2,255,255,224,12,254,144,0,0,45,80,0,2,211,0,31,250,0,0,2,184,0,0,5,176,0,2,182,0,255,215,0,0,12,240,0,7,175,0,2,210,240,0,180,31,0,105,1,240,11,255,255,244,0,1,240,0,0,31,0,12,255,244,0,194,0,0,12,32,0,0,207,233,16,0,2,184,0,0,6,160,0,3,197,0,239,214,0,0,125,246,0,139,48,0,14,16,0,3,201,236,48,79,97,124,3,192,2,224,13,65,139,0,77,235,32,95,255,253,0,0,6,144,0,0,211,0,0,107,0,0,13,64,0,5,192,0,0,197,0,0,77,0,0,6,222,195,1,226,8,160,13,114,183,0,46,251,0,12,131,215,4,208,4,208,62,48,139,0,125,235,32,5,222,144,2,227,26,112,90,0,75,4,210,26,208,8,237,140,0,0,6,144,0,21,226,0,237,179,0,0,109,16,0,6,225,0,0,0,0,0,0,0,0,0,109,16,0,6,225,0,0,109,16,0,6,225,0,0,0,0,0,0,0,0,0,109,16,0,4,244,0,0,78,16,0,140,64,0,0,1,178,0,2,199,0,3,213,0,1,215,0,0,3,213,0,0,2,199,0,0,1,178,0,63,255,252,0,0,0,0,63,255,252,0,0,0,0,0,0,0,0,7,96,0,0,28,128,0,0,26,160,0,0,13,128,0,10,160,0,28,128,0,7,96,0,0,3,234,32,0,1,126,16,0,0,197,0,0,29,64,0,158,144,0,0,0,0,0,183,0,0,11,112,0,1,158,213,0,184,19,209,75,0,7,105,72,237,87,195,195,182,124,89,120,164,210,234,234,11,32,0,0,107,32,0,0,158,235,0,0,141,48,0,12,104,0,3,162,192,0,134,13,32,12,32,135,2,255,255,176,120,0,14,28,64,0,182,31,254,194,1,240,25,144,31,1,167,1,255,253,32,31,1,155,1,240,3,224,31,1,154,1,255,234,16,1,158,252,0,185,32,0,62,0,0,6,176,0,0,106,0,0,4,208,0,0,13,145,0,0,43,239,192,95,253,128,5,160,43,144,90,0,47,5,160,0,242,90,0,15,37,160,3,224,90,3,200,5,255,215,0,12,255,248,0,195,0,0,12,48,0,0,207,255,96,12,48,0,0,195,0,0,12,48,0,0,207,255,128,12,255,248,0,196,0,0,12,64,0,0,207,255,80,12,64,0,0,196,0,0,12,64,0,0,196,0,0,2,174,253,0,201,32,0,92,0,0,8,128,175,224,136,0,30,6,176,1,224,30,113,46,0,59,238,144,90,0,30,5,160,1,224,90,0,30,5,255,255,224,90,0,30,5,160,1,224,90,0,30,5,160,1,224,15,255,249,0,4,192,0,0,76,0,0,4,192,0,0,76,0,0,4,192,0,0,76,0,0,255,255,144,12,255,242,0,0,14,32,0,0,226,0,0,14,32,0,0,226,0,0,14,32,8,20,224,0,126,212,0,30,0,153,1,224,76,16,30,28,48,1,233,96,0,30,181,0,1,225,211,0,30,4,209,1,224,8,176,10,96,0,0,166,0,0,10,96,0,0,166,0,0,10,96,0,0,166,0,0,10,96,0,0,175,255,192,111,16,126,6,182,10,208,118,162,125,24,105,130,193,133,91,12,41,80,0,195,164,0,11,74,64,0,180,79,64,30,4,202,1,224,74,178,30,4,165,129,224,74,12,30,4,160,134,224,74,2,206,4,160,10,224,4,206,177,2,229,25,176,122,0,31,42,112,0,211,151,0,13,72,144,1,241,46,65,154,0,93,234,16,31,254,178,1,240,25,176,31,0,62,1,240,25,160,31,254,145,1,240,0,0,31,0,0,1,240,0,0,4,206,177,2,229,25,176,122,0,31,42,112,0,211,167,0,13,56,144,1,241,62,65,154,0,110,250,16,0,46,32,0,0,126,245,15,254,144,0,241,28,96,15,16,136,0,241,45,80,15,255,144,0,241,127,32,15,16,200,0,241,4,224,5,207,245,2,227,0,0,46,16,0,0,142,130,0,0,57,228,0,0,6,192,0,1,154,5,255,234,16,143,255,255,16,4,192,0,0,76,0,0,4,192,0,0,76,0,0,4,192,0,0,76,0,0,4,192,0,90,0,31,5,160,1,240,90,0,31,5,160,1,240,90,0,31,5,176,2,224,46,49,154,0,109,235,32,197,0,10,103,160,0,225,62,0,91,0,212,9,112,8,144,226,0,61,60,0,0,235,112,0,9,242,0,180,0,9,74,80,0,163,150,0,11,40,99,192,177,119,123,44,22,137,86,192,91,129,188,4,244,10,208,108,0,78,16,198,13,80,3,232,176,0,9,242,0,0,191,48,0,93,108,0,30,80,183,9,176,3,226,184,0,13,83,225,6,192,9,144,211,0,46,138,0,0,143,32,0,4,192,0,0,76,0,0,4,192,0,79,255,251,0,0,11,48,0,5,144,0,0,193,0,0,118,0,0,44,0,0,10,64,0,3,255,255,224,0,255,224,0,15,0,0,0,240,0,0,15,0,0,0,240,0,0,15,0,0,0,240,0,0,15,0,0,0,240,0,0,15,254,0,12,32,0,0,105,0,0,0,209,0,0,8,112,0,0,29,0,0,0,150,0,0,2,192,0,0,11,64,0,0,75,0,5,255,144,0,0,105,0,0,6,144,0,0,105,0,0,6,144,0,0,105,0,0,6,144,0,0,105,0,0,6,144,0,95,249,0,0,110,16,0,28,120,0,7,96,194,1,192,5,160,0,0,0,0,0,0,0,0,0,0,0,0,0,0,0,0,0,15,255,255,249,8,192,0,0,9,128,0,0,0,0,0,0,0,0,0,0,0,0,0,0,0,0,0,0,0,0,0,0,0,0,0,0,11,255,178,0,0,8,128,6,223,249,1,227,6,144,46,19,201,0,158,200,144,30,0,0,1,224,0,0,30,126,211,1,249,23,176,30,0,46,1,224,2,208,30,17,169,1,190,233,16,1,158,248,0,170,16,0,15,32,0,0,241,0,0,11,145,0,0,43,239,128,0,0,105,0,0,6,144,3,207,233,1,229,7,144,75,0,105,5,176,6,144,46,35,217,0,142,199,144,3,206,178,1,195,7,176,79,255,253,4,192,0,0,30,97,0,0,76,255,144,0,27,239,32,8,161,0,0,166,0,8,255,255,240,0,166,0,0,10,96,0,0,166,0,0,10,96,0,5,223,255,32,228,27,96,14,49,182,0,205,234,0,45,33,0,0,238,238,144,92,16,79,2,190,236,80,30,0,0,1,224,0,0,30,126,210,1,249,25,144,30,0,90,1,224,5,160,30,0,90,1,224,5,160,0,93,0,0,5,208,0,0,0,0,0,207,240,0,0,31,0,0,1,240,0,0,31,0,0,1,240,0,15,255,251,0,0,5,208,0,0,93,0,0,0,0,0,255,254,0,0,2,224,0,0,46,0,0,2,224,0,0,46,0,0,2,224,0,0,91,0,79,251,32,0,14,16,0,0,225,0,0,14,16,185,0,225,154,0,14,155,0,0,232,193,0,14,24,177,0,225,9,176,12,255,0,0,1,240,0,0,31,0,0,1,240,0,0,31,0,0,1,240,0,0,31,0,0,255,255,176,121,231,219,7,212,244,225,119,60,13,23,115,192,209,119,60,13,23,115,192,209,29,142,210,1,249,25,144,30,0,90,1,224,5,160,30,0,90,1,224,5,160,4,222,178,2,228,24,176,106,0,31,6,160,1,224,46,49,138,0,109,234,16,29,142,211,1,249,23,176,30,0,46,1,224,2,208,30,17,169,1,255,233,16,30,0,0,1,224,0,0,3,206,217,1,229,7,144,75,0,105,5,176,6,144,46,35,233,0,142,200,144,0,0,105,0,0,6,144,12,125,231,0,202,35,224,12,48,0,0,195,0,0,12,48,0,0,195,0,0,4,207,243,0,197,0,0,7,215,32,0,3,142,64,0,0,152,0,239,251,16,0,208,0,0,15,0,0,159,255,250,0,15,0,0,0,240,0,0,15,0,0,0,229,0,0,5,239,160,30,0,90,1,224,5,160,30,0,90,1,224,6,160,15,51,218,0,126,216,160,107,0,46,17,225,6,144,10,80,179,0,74,28,0,0,198,112,0,8,209,0,180,0,10,89,99,192,195,119,124,29,20,153,101,208,44,146,187,0,246,13,144,46,32,107,0,107,45,32,0,173,80,0,11,182,0,7,145,211,4,225,6,193,107,0,46,1,225,7,112,10,96,193,0,75,56,0,0,201,32,0,7,176,0,1,164,0,10,231,0,0,14,255,246,0,0,42,0,0,11,32,0,8,80,0,4,144,0,0,223,255,176,0,27,228,0,5,177,0,0,104,0,0,9,112,0,31,209,0,0,26,112,0,0,104,0,0,6,128,0,0,92,16,0,0,174,64,0,60,0,0,3,192,0,0,60,0,0,3,192,0,0,60,0,0,3,192,0,0,60,0,0,3,192,0,0,60,0,0,3,192,0,0,60,0,0,3,192,0,10,230,0,0,4,224,0,0,15,0,0,0,228,0,0,6,250,0,0,212,0,0,14,0,0,0,224,0,0,78,0,0,173,96,0,45,231,28,40,115,191,160,0,0,0,0,0,0,0,127,255,255,23,16,0,113,113,235,39,23,16,89,113,113,13,87,23,25,32,113,113,0,7,23,255,255,241,127,255,255,23,16,0,113,113,235,39,23,16,89,113,113,13,87,23,25,32,113,113,0,7,23,255,255,241,127,255,255,23,16,0,113,113,235,39,23,16,89,113,113,13,87,23,25,32,113,113,0,7,23,255,255,241,127,255,255,23,16,0,113,113,235,39,23,16,89,113,113,13,87,23,25,32,113,113,0,7,23,255,255,241,127,255,255,23,16,0,113,113,235,39,23,16,89,113,113,13,87,23,25,32,113,113,0,7,23,255,255,241,127,255,255,23,16,0,113,113,235,39,23,16,89,113,113,13,87,23,25,32,113,113,0,7,23,255,255,241,127,255,255,23,16,0,113,113,235,39,23,16,89,113,113,13,87,23,25,32,113,113,0,7,23,255,255,241,127,255,255,23,16,0,113,113,235,39,23,16,89,113,113,13,87,23,25,32,113,113,0,7,23,255,255,241,127,255,255,23,16,0,113,113,235,39,23,16,89,113,113,13,87,23,25,32,113,113,0,7,23,255,255,241,127,255,255,23,16,0,113,113,235,39,23,16,89,113,113,13,87,23,25,32,113,113,0,7,23,255,255,241,127,255,255,23,16,0,113,113,235,39,23,16,89,113,113,13,87,23,25,32,113,113,0,7,23,255,255,241,127,255,255,23,16,0,113,113,235,39,23,16,89,113,113,13,87,23,25,32,113,113,0,7,23,255,255,241,127,255,255,23,16,0,113,113,235,39,23,16,89,113,113,13,87,23,25,32,113,113,0,7,23,255,255,241,127,255,255,23,16,0,113,113,235,39,23,16,89,113,113,13,87,23,25,32,113,113,0,7,23,255,255,241,127,255,255,23,16,0,113,113,235,39,23,16,89,113,113,13,87,23,25,32,113,113,0,7,23,255,255,241,127,255,255,23,16,0,113,113,235,39,23,16,89,113,113,13,87,23,25,32,113,113,0,7,23,255,255,241,127,255,255,23,16,0,113,113,235,39,23,16,89,113,113,13,87,23,25,32,113,113,0,7,23,255,255,241,127,255,255,23,16,0,113,113,235,39,23,16,89,113,113,13,87,23,25,32,113,113,0,7,23,255,255,241,127,255,255,23,16,0,113,113,235,39,23,16,89,113,113,13,87,23,25,32,113,113,0,7,23,255,255,241,127,255,255,23,16,0,113,113,235,39,23,16,89,113,113,13,87,23,25,32,113,113,0,7,23,255,255,241,127,255,255,23,16,0,113,113,235,39,23,16,89,113,113,13,87,23,25,32,113,113,0,7,23,255,255,241,127,255,255,23,16,0,113,113,235,39,23,16,89,113,113,13,87,23,25,32,113,113,0,7,23,255,255,241,127,255,255,23,16,0,113,113,235,39,23,16,89,113,113,13,87,23,25,32,113,113,0,7,23,255,255,241,127,255,255,23,16,0,113,113,235,39,23,16,89,113,113,13,87,23,25,32,113,113,0,7,23,255,255,241,127,255,255,23,16,0,113,113,235,39,23,16,89,113,113,13,87,23,25,32,113,113,0,7,23,255,255,241,127,255,255,23,16,0,113,113,235,39,23,16,89,113,113,13,87,23,25,32,113,113,0,7,23,255,255,241,127,255,255,23,16,0,113,113,235,39,23,16,89,113,113,13,87,23,25,32,113,113,0,7,23,255,255,241,127,255,255,23,16,0,113,113,235,39,23,16,89,113,113,13,87,23,25,32,113,113,0,7,23,255,255,241,127,255,255,23,16,0,113,113,235,39,23,16,89,113,113,13,87,23,25,32,113,113,0,7,23,255,255,241,127,255,255,23,16,0,113,113,235,39,23,16,89,113,113,13,87,23,25,32,113,113,0,7,23,255,255,241,127,255,255,23,16,0,113,113,235,39,23,16,89,113,113,13,87,23,25,32,113,113,0,7,23,255,255,241,127,255,255,23,16,0,113,113,235,39,23,16,89,113,113,13,87,23,25,32,113,113,0,7,23,255,255,241,127,255,255,23,16,0,113,113,235,39,23,16,89,113,113,13,87,23,25,32,113,113,0,7,23,255,255,241,0,77,0,0,4,208,0,0,0,0,0,2,192,0,0,60,0,0,3,208,0,0,77,0,0,4,224,0,0,4,144,0,0,103,0,2,190,245,0,215,164,0,61,11,16,3,208,208,0,30,92,0,0,76,255,80,0,73,0,0,7,96,0,0,158,212,0,107,19,128,8,128,0,7,255,255,16,8,128,0,0,136,0,0,8,128,0,7,255,255,208,42,0,41,2,205,238,112,10,113,197,0,211,9,112,11,113,196,1,205,238,128,42,0,41,0,92,0,61,16,183,11,80,2,231,160,0,7,226,0,15,255,249,0,4,192,0,15,255,249,0,4,192,0,0,60,0,0,3,192,0,0,60,0,0,3,192,0,0,60,0,0,0,0,0,0,0,0,0,3,192,0,0,60,0,0,3,192,0,0,60,0,0,3,192,0,1,174,242,0,122,16,0,6,211,0,0,200,216,0,45,1,184,0,215,4,192,1,187,182,0,0,110,16,0,2,226,0,255,214,0,7,128,209,0,0,0,0,0,0,0,0,0,0,0,0,0,0,0,0,0,0,0,0,0,0,0,0,0,5,223,177,3,211,23,192,164,159,138,77,60,16,103,211,193,6,122,74,248,164,77,49,108,0,93,251,32,3,238,128,0,0,46,0,4,223,224,0,94,189,0,0,0,0,0,175,255,64,0,0,0,0,0,0,0,1,176,102,0,135,45,16,30,24,112,0,136,45,16,1,176,102,0,0,0,0,95,255,250,0,0,5,160,0,0,90,0,0,0,0,7,255,241,0,0,0,0,0,0,0,0,0,0,0,4,206,161,2,179,21,160,85,191,58,2,178,21,160,4,222,161,0,0,0,0,0,0,0,0,0,0,0,4,255,192,0,0,0,0,0,0,0,0,0,0,0,0,0,0,0,0,0,0,0,0,0,0,0,0,0,2,206,160,0,166,28,64,10,97,195,0,61,232,0,0,0,0,0,0,0,0,0,0,0,0,0,0,0,0,60,0,0,3,192,0,111,255,255,0,3,192,0,0,60,0,0,0,0,0,63,255,252,0,4,254,96,0,0,93,0,0,10,128,0,28,128,0,8,255,243,0,0,0,0,0,0,0,0,0,0,0,0,0,0,0,4,238,112,0,0,107,0,0,191,128,0,0,79,0,5,254,112,0,0,0,0,0,0,0,0,0,0,0,0,0,0,0,0,4,227,0,1,211,0,0,0,0,0,0,0,0,0,0,0,0,0,0,0,0,0,0,0,0,0,0,0,0,0,0,30,0,105,1,224,6,144,30,0,105,1,224,7,144,31,50,218,1,237,213,229,30,0,0,1,224,0,0,4,206,253,2,255,211,208,95,253,61,2,255,211,208,5,220,61,0,0,3,208,0,0,61,0,0,3,192,6,97,153,0,60,235,16,0,126,32,0,7,226,0,0,0,0,0,0,0,0,0,44,0,0,5,144,0,2,174,0,0,120,240,0,0,31,0,0,1,240,0,7,255,242,0,0,0,0,0,0,0,0,0,0,0,0,0,0,0,2,206,160,0,151,28,48,9,113,195,0,61,232,0,0,0,0,0,175,255,64,0,0,0,0,0,0,0,0,0,0,0,177,72,0,6,160,211,0,13,38,144,6,160,211,0,177,89,0,0,0,0,0,77,80,12,56,165,7,112,8,83,176,0,0,194,0,0,135,0,0,59,75,192,12,45,255,88,96,2,192,77,80,12,56,165,7,112,8,83,176,0,0,194,0,0,135,0,0,59,47,209,12,32,104,8,96,79,245,111,96,12,48,121,7,112,79,115,176,0,93,194,0,126,231,0,0,59,75,192,12,45,255,88,96,2,192,0,13,80,0,0,213,0,0,0,0,0,60,243,0,10,128,0,0,182,0,0,6,212,0,0,6,220,0,6,225,0,0,8,144,0,0,0,0,0,8,211,0,0,198,128,0,58,44,0,8,96,210,0,194,8,112,47,255,251,7,128,0,225,196,0,11,96,0,6,209,0,1,211,0,0,0,0,0,8,211,0,0,198,128,0,58,44,0,8,96,210,0,194,8,112,47,255,251,7,128,0,225,196,0,11,96,0,143,32,0,61,108,0,0,0,0,0,8,211,0,0,198,128,0,58,44,0,8,96,210,0,194,8,112,47,255,251,7,128,0,225,196,0,11,96,6,231,83,0,114,189,32,0,0,0,0,8,211,0,0,198,128,0,58,44,0,8,96,210,0,194,8,112,47,255,251,7,128,0,225,196,0,11,96,7,112,193,0,0,0,0,0,141,48,0,12,104,0,3,162,192,0,134,13,32,12,32,135,2,255,255,176,120,0,14,28,64,0,182,0,142,48,0,11,87,0,0,142,48,0,8,211,0,0,198,128,0,58,44,0,8,96,210,0,194,8,112,47,255,251,7,128,0,225,196,0,11,96,0,5,255,244,0,11,166,0,0,42,150,0,0,133,159,243,0,192,150,0,4,255,246,0,10,64,150,0,30,0,159,245,1,158,252,0,185,32,0,62,0,0,6,176,0,0,106,0,0,4,208,0,0,13,145,0,0,43,255,192,0,45,0,0,5,144,0,6,225,0,0,8,144,0,0,0,0,0,207,255,128,12,48,0,0,195,0,0,12,255,246,0,195,0,0,12,48,0,0,195,0,0,12,255,248,0,0,6,209,0,1,211,0,0,0,0,0,207,255,128,12,48,0,0,195,0,0,12,255,246,0,195,0,0,12,48,0,0,195,0,0,12,255,248,0,0,143,32,0,61,108,0,0,0,0,0,207,255,128,12,48,0,0,195,0,0,12,255,246,0,195,0,0,12,48,0,0,195,0,0,12,255,248,0,7,112,193,0,0,0,0,12,255,248,0,195,0,0,12,48,0,0,207,255,96,12,48,0,0,195,0,0,12,48,0,0,207,255,128,6,225,0,0,8,144,0,0,0,0,0,255,255,144,0,76,0,0,4,192,0,0,76,0,0,4,192,0,0,76,0,0,4,192,0,15,255,249,0,0,6,209,0,1,211,0,0,0,0,0,255,255,144,0,76,0,0,4,192,0,0,76,0,0,4,192,0,0,76,0,0,4,192,0,15,255,249,0,0,143,32,0,61,108,0,0,0,0,0,255,255,144,0,76,0,0,4,192,0,0,76,0,0,4,192,0,0,76,0,0,4,192,0,15,255,249,0,7,112,193,0,0,0,0,15,255,249,0,4,192,0,0,76,0,0,4,192,0,0,76,0,0,4,192,0,0,76,0,0,255,255,144,63,253,129,3,208,43,160,61,0,47,31,255,48,242,61,0,15,35,208,3,224,61,3,200,3,255,215,0,6,231,83,0,114,189,32,0,0,0,4,244,1,224,76,160,30,4,171,33,224,74,88,30,4,160,193,224,74,8,110,4,160,44,224,74,0,174,0,6,225,0,0,8,144,0,0,0,0,0,76,235,16,46,81,155,7,160,1,242,167,0,13,57,112,0,212,137,0,31,18,228,25,160,5,222,161,0,0,6,209,0,1,211,0,0,0,0,0,76,235,16,46,81,155,7,160,1,242,167,0,13,57,112,0,212,137,0,31,18,228,25,160,5,222,161,0,0,143,32,0,61,108,0,0,0,0,0,76,235,16,46,81,155,7,160,1,242,167,0,13,57,112,0,212,137,0,31,18,228,25,160,5,222,161,0,6,231,83,0,114,189,32,0,0,0,0,76,235,16,46,81,155,7,160,1,242,167,0,13,57,112,0,212,137,0,31,18,228,25,160,5,222,161,0,7,112,193,0,0,0,0,4,206,177,2,229,25,176,122,0,31,42,112,0,211,151,0,13,72,144,1,241,46,65,154,0,93,234,16,11,48,118,0,94,152,0,0,159,112,0,137,45,96,4,0,34,0,0,0,0,0,0,177,0,76,238,32,46,86,219,7,160,163,242,167,12,13,58,116,144,211,137,148,30,19,237,25,144,7,254,161,0,118,0,0,6,225,0,0,8,144,0,0,0,0,5,160,1,240,90,0,31,5,160,1,240,90,0,31,5,160,1,240,91,0,46,2,227,25,160,6,222,178,0,0,6,209,0,1,211,0,0,0,0,5,160,1,240,90,0,31,5,160,1,240,90,0,31,5,160,1,240,91,0,46,2,227,25,160,6,222,178,0,0,143,32,0,61,108,0,0,0,0,5,160,1,240,90,0,31,5,160,1,240,90,0,31,5,160,1,240,91,0,46,2,227,25,160,6,222,178,0,7,112,193,0,0,0,0,90,0,31,5,160,1,240,90,0,31,5,160,1,240,90,0,31,5,176,2,224,46,49,154,0,109,235,32,0,6,209,0,1,211,0,0,0,0,11,128,0,213,62,16,108,0,153,13,48,2,232,160,0,8,242,0,0,76,0,0,4,192,0,0,76,0,0,31,0,0,1,255,235,32,31,1,155,1,240,3,224,31,1,154,1,255,233,16,31,0,0,1,240,0,0,5,222,177,0,228,11,96,46,4,210,2,209,225,0,45,13,112,2,208,27,144,45,0,62,2,210,253,96,8,192,0,0,9,128,0,0,0,0,0,191,251,32,0,0,136,0,109,255,144,30,48,105,2,225,60,144,9,236,137,0,0,4,227,0,1,211,0,0,0,0,0,191,251,32,0,0,136,0,109,255,144,30,48,105,2,225,60,144,9,236,137,0,0,126,32,0,60,92,0,0,0,0,0,191,251,32,0,0,136,0,109,255,144,30,48,105,2,225,60,144,9,236,137,0,6,231,83,0,114,189,32,0,0,0,0,191,251,32,0,0,136,0,109,255,144,30,48,105,2,225,60,144,9,236,137,0,7,128,209,0,0,0,0,11,255,178,0,0,8,128,6,223,249,1,227,6,144,46,19,201,0,158,200,144,0,142,48,0,11,72,0,0,142,48,0,0,0,0,11,255,178,0,0,8,128,6,223,249,1,227,6,144,46,19,201,0,158,200,144,143,232,235,0,4,209,180,77,255,255,91,98,192,0,196,143,32,6,233,126,242,1,158,248,0,170,16,0,14,32,0,0,241,0,0,12,145,0,0,60,255,128,0,45,0,0,5,144,0,8,192,0,0,9,128,0,0,0,0,0,60,235,32,28,48,123,4,255,255,208,76,0,0,1,230,16,0,4,207,249,0,0,4,227,0,1,211,0,0,0,0,0,60,235,32,28,48,123,4,255,255,208,76,0,0,1,230,16,0,4,207,249,0,0,126,32,0,60,92,0,0,0,0,0,60,235,32,28,48,123,4,255,255,208,76,0,0,1,230,16,0,4,207,249,0,7,128,209,0,0,0,0,3,206,178,1,195,7,176,79,255,253,4,192,0,0,30,97,0,0,76,255,144,8,192,0,0,9,128,0,0,0,0,0,207,240,0,0,31,0,0,1,240,0,0,31,0,0,1,240,0,15,255,251,0,0,4,227,0,1,211,0,0,0,0,0,207,240,0,0,31,0,0,1,240,0,0,31,0,0,1,240,0,15,255,251,0,0,126,32,0,60,92,0,0,0,0,0,207,240,0,0,31,0,0,1,240,0,0,31,0,0,1,240,0,15,255,251,0,7,128,209,0,0,0,0,12,255,0,0,1,240,0,0,31,0,0,1,240,0,0,31,0,0,255,255,176,1,203,197,0,139,231,0,0,9,208,0,76,255,80,30,64,154,5,176,4,208,91,0,60,2,228,26,128,6,222,144,0,6,231,83,0,114,189,32,0,0,0,1,216,237,32,31,145,153,1,224,5,160,30,0,90,1,224,5,160,30,0,90,0,8,192,0,0,9,128,0,0,0,0,0,77,235,32,46,65,139,6,160,1,240,106,0,30,2,227,24,160,6,222,161,0,0,4,227,0,1,211,0,0,0,0,0,77,235,32,46,65,139,6,160,1,240,106,0,30,2,227,24,160,6,222,161,0,0,126,32,0,60,92,0,0,0,0,0,77,235,32,46,65,139,6,160,1,240,106,0,30,2,227,24,160,6,222,161,0,6,231,83,0,114,189,32,0,0,0,0,77,235,32,46,65,139,6,160,1,240,106,0,30,2,227,24,160,6,222,161,0,7,128,209,0,0,0,0,4,222,178,2,228,24,176,106,0,31,6,160,1,224,46,49,138,0,109,234,16,0,93,0,0,5,208,0,0,0,0,8,255,255,242,0,0,0,0,5,208,0,0,93,0,0,0,0,192,0,93,253,32,46,73,188,6,160,193,240,106,88,14,2,236,72,176,6,254,162,0,88,0,0,8,192,0,0,9,128,0,0,0,0,1,224,5,160,30,0,90,1,224,5,160,30,0,106,0,243,61,160,7,237,138,0,0,4,227,0,1,211,0,0,0,0,1,224,5,160,30,0,90,1,224,5,160,30,0,106,0,243,61,160,7,237,138,0,0,126,32,0,60,92,0,0,0,0,1,224,5,160,30,0,90,1,224,5,160,30,0,106,0,243,61,160,7,237,138,0,7,128,209,0,0,0,0,30,0,90,1,224,5,160,30,0,90,1,224,6,160,15,51,218,0,126,216,160,0,4,227,0,1,211,0,0,0,0,6,176,2,224,30,16,119,0,166,12,16,4,179,128,0,12,146,0,0,123,0,0,26,64,0,174,112,0,0,30,0,0,1,224,0,0,30,126,211,1,249,23,176,30,0,46,1,224,2,208,30,17,169,1,254,233,16,30,0,0,1,224,0,0,7,128,209,0,0,0,0,107,0,46,1,225,7,112,10,96,193,0,75,56,0,0,201,32,0,7,176,0,1,164,0,10,231,0,0
};
static const StrandGlyph StrandSmallGlyphs[] PROGMEM={
{0,7,0,7,0,0},
{0,7,8,7,0,-8},
{28,7,8,7,0,-8},
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{6424,7,10,7,0,-8}
};
const StrandFont StrandSmall={StrandSmallBits,StrandSmallGlyphs,15};
