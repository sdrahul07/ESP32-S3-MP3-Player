static const uint8_t StrandClockBits[] PROGMEM={
0,0,255,255,255,255,255,255,255,224,0,0,0,255,255,255,255,255,255,255,224,0,0,0,119,119,119,119,119,119,119,96,0,0,0,0,0,0,0,0,0,0,0,0,0,0,0,0,0,0,0,0,0,0,0,0,0,0,0,0,0,0,0,0,0,0,0,0,0,0,0,0,0,0,0,0,0,0,0,0,0,0,0,0,0,0,0,0,0,0,0,0,0,0,0,0,0,0,0,0,0,0,0,0,0,0,0,0,0,0,0,0,0,0,0,0,0,0,0,0,0,0,0,0,0,0,0,0,0,0,0,0,0,0,0,0,0,0,0,0,0,0,0,0,0,0,0,0,0,0,0,0,0,0,0,0,0,0,0,0,0,0,0,0,0,0,0,0,0,0,0,0,0,0,0,0,0,0,0,0,0,0,0,0,0,0,0,0,0,0,0,0,0,0,0,0,0,0,0,0,0,0,0,39,190,255,219,97,0,0,0,0,0,0,0,0,1,159,255,255,255,255,230,0,0,0,0,0,0,0,2,223,254,150,85,140,255,249,0,0,0,0,0,0,2,223,249,16,0,0,5,239,248,0,0,0,0,0,0,191,246,0,0,0,0,3,239,244,0,0,0,0,0,111,248,0,0,0,0,0,5,255,192,0,0,0,0,30,253,0,0,0,0,0,0,10,255,64,0,0,0,6,255,80,0,0,0,0,0,0,63,250,0,0,0,0,207,208,0,0,0,0,0,0,0,223,224,0,0,0,47,248,0,0,0,0,0,0,0,8,255,64,0,0,6,255,64,0,0,0,0,0,0,0,79,247,0,0,0,159,240,0,0,0,0,0,0,0,1,255,160,0,0,12,252,0,0,0,0,0,0,0,0,13,253,0,0,0,255,144,0,0,0,0,0,0,0,0,191,224,0,0,31,247,0,0,0,0,0,0,0,0,9,255,16,0,3,255,96,0,0,0,0,0,0,0,0,143,242,0,0,79,245,0,0,0,0,0,0,0,0,7,255,48,0,5,255,64,0,0,0,0,0,0,0,0,111,244,0,0,111,243,0,0,0,0,0,0,0,0,6,255,64,0,6,255,48,0,0,0,0,0,0,0,0,111,244,0,0,111,243,0,0,0,0,0,0,0,0,6,255,64,0,6,255,64,0,0,0,0,0,0,0,0,127,243,0,0,111,245,0,0,0,0,0,0,0,0,7,255,48,0,5,255,80,0,0,0,0,0,0,0,0,143,242,0,0,63,247,0,0,0,0,0,0,0,0,10,255,0,0,2,255,144,0,0,0,0,0,0,0,0,207,208,0,0,15,251,0,0,0,0,0,0,0,0,14,251,0,0,0,207,224,0,0,0,0,0,0,0,2,255,128,0,0,9,255,32,0,0,0,0,0,0,0,111,245,0,0,0,95,246,0,0,0,0,0,0,0,10,255,16,0,0,1,255,192,0,0,0,0,0,0,1,239,176,0,0,0,11,255,48,0,0,0,0,0,0,127,245,0,0,0,0,79,250,0,0,0,0,0,0,29,253,0,0,0,0,0,207,245,0,0,0,0,0,9,255,80,0,0,0,0,3,255,227,0,0,0,0,6,255,176,0,0,0,0,0,6,255,230,0,0,0,24,255,209,0,0,0,0,0,0,7,255,253,133,86,158,255,194,0,0,0,0,0,0,0,4,223,255,255,255,255,145,0,0,0,0,0,0,0,0,0,90,223,254,183,32,0,0,0,0,0,0,0,0,0,0,0,61,96,0,0,0,0,0,0,0,5,239,96,0,0,0,0,0,0,0,143,255,96,0,0,0,0,0,0,60,255,255,96,0,0,0,0,0,41,255,212,255,96,0,0,0,0,40,239,249,18,255,96,0,0,0,91,255,252,48,2,255,96,0,0,0,191,251,64,0,2,255,96,0,0,0,168,32,0,0,2,255,96,0,0,0,0,0,0,0,2,255,96,0,0,0,0,0,0,0,2,255,96,0,0,0,0,0,0,0,2,255,96,0,0,0,0,0,0,0,2,255,96,0,0,0,0,0,0,0,2,255,96,0,0,0,0,0,0,0,2,255,96,0,0,0,0,0,0,0,2,255,96,0,0,0,0,0,0,0,2,255,96,0,0,0,0,0,0,0,2,255,96,0,0,0,0,0,0,0,2,255,96,0,0,0,0,0,0,0,2,255,96,0,0,0,0,0,0,0,2,255,96,0,0,0,0,0,0,0,2,255,96,0,0,0,0,0,0,0,2,255,96,0,0,0,0,0,0,0,2,255,96,0,0,0,0,0,0,0,2,255,96,0,0,0,0,0,0,0,2,255,96,0,0,0,0,0,0,0,2,255,96,0,0,0,0,0,0,0,2,255,96,0,0,0,0,0,0,0,2,255,96,0,0,0,0,0,0,0,2,255,96,0,0,0,0,0,0,0,2,255,96,0,0,0,0,0,0,0,2,255,96,0,0,0,0,0,0,0,2,255,96,0,0,0,0,0,0,0,2,255,96,0,0,0,0,0,0,0,2,255,96,0,0,0,0,0,0,0,2,255,96,0,0,0,0,0,0,0,2,255,96,0,0,0,0,0,0,0,2,255,96,0,0,0,0,0,0,0,2,255,96,0,0,0,0,0,0,0,2,255,96,0,0,0,0,0,0,3,123,206,254,201,80,0,0,0,0,0,0,0,0,92,255,255,255,255,255,214,0,0,0,0,0,0,4,223,255,200,101,86,157,255,250,0,0,0,0,0,8,255,250,48,0,0,0,5,239,250,0,0,0,0,0,223,179,0,0,0,0,0,1,223,245,0,0,0,0,12,112,0,0,0,0,0,0,2,255,208,0,0,0,0,32,0,0,0,0,0,0,0,9,255,64,0,0,0,0,0,0,0,0,0,0,0,0,63,248,0,0,0,0,0,0,0,0,0,0,0,0,0,255,160,0,0,0,0,0,0,0,0,0,0,0,0,14,251,0,0,0,0,0,0,0,0,0,0,0,0,0,223,176,0,0,0,0,0,0,0,0,0,0,0,0,14,250,0,0,0,0,0,0,0,0,0,0,0,0,1,255,128,0,0,0,0,0,0,0,0,0,0,0,0,95,244,0,0,0,0,0,0,0,0,0,0,0,0,11,254,16,0,0,0,0,0,0,0,0,0,0,0,3,255,128,0,0,0,0,0,0,0,0,0,0,0,0,207,225,0,0,0,0,0,0,0,0,0,0,0,0,159,246,0,0,0,0,0,0,0,0,0,0,0,0,143,249,0,0,0,0,0,0,0,0,0,0,0,0,159,251,0,0,0,0,0,0,0,0,0,0,0,1,191,250,0,0,0,0,0,0,0,0,0,0,0,4,239,247,0,0,0,0,0,0,0,0,0,0,0,8,255,212,0,0,0,0,0,0,0,0,0,0,0,44,255,161,0,0,0,0,0,0,0,0,0,0,0,110,254,96,0,0,0,0,0,0,0,0,0,0,1,175,252,32,0,0,0,0,0,0,0,0,0,0,2,207,249,0,0,0,0,0,0,0,0,0,0,0,3,239,245,0,0,0,0,0,0,0,0,0,0,0,3,239,227,0,0,0,0,0,0,0,0,0,0,0,1,223,227,0,0,0,0,0,0,0,0,0,0,0,0,175,244,0,0,0,0,0,0,0,0,0,0,0,0,63,248,0,0,0,0,0,0,0,0,0,0,0,0,10,254,16,0,0,0,0,0,0,0,0,0,0,0,0,239,176,0,0,0,0,0,0,0,0,0,0,0,0,47,247,0,0,0,0,0,0,0,0,0,0,0,0,4,255,96,0,0,0,0,0,0,0,0,0,0,0,0,95,248,68,68,68,68,68,68,68,68,68,64,0,0,6,255,255,255,255,255,255,255,255,255,255,252,0,0,0,111,255,255,255,255,255,255,255,255,255,255,192,0,0,0,0,0,1,89,206,254,219,114,0,0,0,0,0,0,0,0,57,239,255,255,255,255,250,32,0,0,0,0,0,0,79,255,235,118,86,123,255,254,64,0,0,0,0,0,4,252,97,0,0,0,2,175,254,48,0,0,0,0,0,53,0,0,0,0,0,0,143,252,0,0,0,0,0,0,0,0,0,0,0,0,0,207,244,0,0,0,0,0,0,0,0,0,0,0,0,5,255,144,0,0,0,0,0,0,0,0,0,0,0,0,15,252,0,0,0,0,0,0,0,0,0,0,0,0,0,207,208,0,0,0,0,0,0,0,0,0,0,0,0,11,253,0,0,0,0,0,0,0,0,0,0,0,0,0,207,192,0,0,0,0,0,0,0,0,0,0,0,0,14,250,0,0,0,0,0,0,0,0,0,0,0,0,3,255,96,0,0,0,0,0,0,0,0,0,0,0,0,159,241,0,0,0,0,0,0,0,0,0,0,0,0,79,249,0,0,0,0,0,0,0,0,0,0,0,0,62,252,16,0,0,0,0,0,0,0,0,0,0,1,143,252,32,0,0,0,0,0,0,0,0,1,35,106,255,248,16,0,0,0,0,0,0,0,47,255,255,255,253,130,0,0,0,0,0,0,0,0,2,255,255,255,255,235,131,0,0,0,0,0,0,0,0,20,68,86,121,191,255,251,48,0,0,0,0,0,0,0,0,0,0,0,21,207,255,80,0,0,0,0,0,0,0,0,0,0,0,0,94,255,80,0,0,0,0,0,0,0,0,0,0,0,0,62,254,16,0,0,0,0,0,0,0,0,0,0,0,0,111,248,0,0,0,0,0,0,0,0,0,0,0,0,0,223,224,0,0,0,0,0,0,0,0,0,0,0,0,9,255,32,0,0,0,0,0,0,0,0,0,0,0,0,111,244,0,0,0,0,0,0,0,0,0,0,0,0,5,255,64,0,0,0,0,0,0,0,0,0,0,0,0,111,243,0,0,0,0,0,0,0,0,0,0,0,0,8,255,16,0,0,0,0,0,0,0,0,0,0,0,0,223,192,0,0,0,0,0,0,0,0,0,0,0,0,111,246,0,0,0,0,0,0,0,0,0,0,0,0,46,253,0,0,0,0,6,16,0,0,0,0,0,0,62,255,64,0,0,0,0,222,148,0,0,0,0,2,159,255,64,0,0,0,0,13,255,254,167,101,86,156,255,253,48,0,0,0,0,0,57,239,255,255,255,255,255,215,16,0,0,0,0,0,0,0,72,189,239,237,184,64,0,0,0,0,0,0,0,0,0,0,0,0,0,0,0,5,255,144,0,0,0,0,0,0,0,0,0,0,0,0,13,255,144,0,0,0,0,0,0,0,0,0,0,0,0,111,255,144,0,0,0,0,0,0,0,0,0,0,0,1,223,255,144,0,0,0,0,0,0,0,0,0,0,0,8,254,255,144,0,0,0,0,0,0,0,0,0,0,0,46,247,239,144,0,0,0,0,0,0,0,0,0,0,0,175,208,239,144,0,0,0,0,0,0,0,0,0,0,4,255,64,239,144,0,0,0,0,0,0,0,0,0,0,29,250,0,239,144,0,0,0,0,0,0,0,0,0,0,143,225,0,239,144,0,0,0,0,0,0,0,0,0,3,255,96,0,239,144,0,0,0,0,0,0,0,0,0,29,251,0,0,239,144,0,0,0,0,0,0,0,0,0,143,226,0,0,239,144,0,0,0,0,0,0,0,0,4,255,96,0,0,239,144,0,0,0,0,0,0,0,0,30,251,0,0,0,239,144,0,0,0,0,0,0,0,0,191,226,0,0,0,239,144,0,0,0,0,0,0,0,7,255,80,0,0,0,239,144,0,0,0,0,0,0,0,63,250,0,0,0,0,239,144,0,0,0,0,0,0,1,223,209,0,0,0,0,239,144,0,0,0,0,0,0,10,255,48,0,0,0,0,239,144,0,0,0,0,0,0,127,246,0,0,0,0,0,239,144,0,0,0,0,0,4,255,160,0,0,0,0,0,239,144,0,0,0,0,0,46,252,16,0,0,0,0,0,239,144,0,0,0,0,1,207,226,0,0,0,0,0,0,239,144,0,0,0,0,10,255,80,0,0,0,0,0,0,239,144,0,0,0,0,143,247,0,0,0,0,0,0,0,239,144,0,0,0,5,255,160,0,0,0,0,0,0,0,239,144,0,0,0,9,255,255,255,255,255,255,255,255,255,255,255,255,255,176,9,255,255,255,255,255,255,255,255,255,255,255,255,255,176,2,68,68,68,68,68,68,68,68,68,239,180,68,68,48,0,0,0,0,0,0,0,0,0,0,239,144,0,0,0,0,0,0,0,0,0,0,0,0,0,239,144,0,0,0,0,0,0,0,0,0,0,0,0,0,239,144,0,0,0,0,0,0,0,0,0,0,0,0,0,239,144,0,0,0,0,0,0,0,0,0,0,0,0,0,239,144,0,0,0,0,0,0,0,0,0,0,0,0,0,239,144,0,0,0,0,0,0,0,0,0,0,0,0,0,239,144,0,0,0,0,0,0,0,0,0,0,0,0,0,239,144,0,0,0,0,0,0,0,0,0,0,0,0,0,239,144,0,0,0,0,0,0,95,255,255,255,255,255,255,255,241,0,0,0,0,0,6,255,255,255,255,255,255,255,255,16,0,0,0,0,0,127,228,68,68,68,68,68,68,64,0,0,0,0,0,8,253,0,0,0,0,0,0,0,0,0,0,0,0,0,159,192,0,0,0,0,0,0,0,0,0,0,0,0,9,251,0,0,0,0,0,0,0,0,0,0,0,0,0,175,160,0,0,0,0,0,0,0,0,0,0,0,0,11,249,0,0,0,0,0,0,0,0,0,0,0,0,0,207,128,0,0,0,0,0,0,0,0,0,0,0,0,13,247,0,0,0,0,0,0,0,0,0,0,0,0,0,239,96,0,0,0,0,0,0,0,0,0,0,0,0,15,246,0,0,0,0,0,0,0,0,0,0,0,0,1,255,80,0,0,0,0,0,0,0,0,0,0,0,0,47,244,0,0,0,0,0,0,0,0,0,0,0,0,3,255,48,0,0,0,0,0,0,0,0,0,0,0,0,79,242,0,0,0,0,0,0,0,0,0,0,0,0,5,255,205,239,254,219,116,0,0,0,0,0,0,0,0,111,255,255,255,255,255,253,96,0,0,0,0,0,0,4,135,101,85,102,156,255,255,194,0,0,0,0,0,0,0,0,0,0,0,1,126,255,210,0,0,0,0,0,0,0,0,0,0,0,0,27,255,192,0,0,0,0,0,0,0,0,0,0,0,0,11,255,96,0,0,0,0,0,0,0,0,0,0,0,0,47,253,0,0,0,0,0,0,0,0,0,0,0,0,0,159,243,0,0,0,0,0,0,0,0,0,0,0,0,4,255,112,0,0,0,0,0,0,0,0,0,0,0,0,31,249,0,0,0,0,0,0,0,0,0,0,0,0,0,255,160,0,0,0,0,0,0,0,0,0,0,0,0,14,250,0,0,0,0,0,0,0,0,0,0,0,0,0,255,144,0,0,0,0,0,0,0,0,0,0,0,0,47,248,0,0,0,0,0,0,0,0,0,0,0,0,6,255,64,0,0,0,0,0,0,0,0,0,0,0,0,191,224,0,0,0,0,0,0,0,0,0,0,0,0,79,248,0,0,0,0,0,0,0,0,0,0,0,0,46,254,16,0,0,0,0,16,0,0,0,0,0,0,61,255,80,0,0,0,0,9,181,0,0,0,0,2,143,255,112,0,0,0,0,0,159,254,184,101,86,140,255,254,80,0,0,0,0,0,7,239,255,255,255,255,255,233,32,0,0,0,0,0,0,1,89,189,239,237,201,81,0,0,0,0,0,0,0,0,0,0,0,0,1,106,222,254,219,132,0,0,0,0,0,0,0,0,25,255,255,255,255,255,245,0,0,0,0,0,0,0,94,255,251,133,85,122,223,80,0,0,0,0,0,0,143,255,146,0,0,0,0,66,0,0,0,0,0,0,127,254,64,0,0,0,0,0,0,0,0,0,0,0,95,253,32,0,0,0,0,0,0,0,0,0,0,0,30,254,48,0,0,0,0,0,0,0,0,0,0,0,9,255,96,0,0,0,0,0,0,0,0,0,0,0,2,255,208,0,0,0,0,0,0,0,0,0,0,0,0,143,245,0,0,0,0,0,0,0,0,0,0,0,0,13,253,0,0,0,0,0,0,0,0,0,0,0,0,4,255,112,0,0,0,0,0,0,0,0,0,0,0,0,143,242,0,0,0,0,0,0,0,0,0,0,0,0,12,253,0,0,0,0,0,0,0,0,0,0,0,0,0,239,160,0,0,0,0,0,0,0,0,0,0,0,0,47,247,0,0,56,206,254,218,81,0,0,0,0,0,5,255,64,2,191,255,255,255,255,230,0,0,0,0,0,111,242,4,239,252,134,86,157,255,250,0,0,0,0,8,255,20,255,179,0,0,0,6,239,251,0,0,0,0,159,241,223,128,0,0,0,0,2,207,247,0,0,0,9,255,143,112,0,0,0,0,0,2,239,242,0,0,0,159,255,176,0,0,0,0,0,0,6,255,128,0,0,9,255,243,0,0,0,0,0,0,0,14,254,0,0,0,143,251,0,0,0,0,0,0,0,0,159,243,0,0,8,255,112,0,0,0,0,0,0,0,5,255,96,0,0,127,245,0,0,0,0,0,0,0,0,63,247,0,0,5,255,64,0,0,0,0,0,0,0,2,255,128,0,0,47,245,0,0,0,0,0,0,0,0,47,247,0,0,0,255,112,0,0,0,0,0,0,0,3,255,96,0,0,12,251,0,0,0,0,0,0,0,0,111,243,0,0,0,127,225,0,0,0,0,0,0,0,10,254,0,0,0,2,255,112,0,0,0,0,0,0,2,255,160,0,0,0,11,254,16,0,0,0,0,0,0,159,243,0,0,0,0,79,250,0,0,0,0,0,0,79,251,0,0,0,0,0,175,249,0,0,0,0,0,78,254,16,0,0,0,0,1,223,252,48,0,0,1,143,254,64,0,0,0,0,0,2,207,255,183,85,122,239,253,48,0,0,0,0,0,0,1,159,255,255,255,255,248,16,0,0,0,0,0,0,0,0,39,190,254,218,97,0,0,0,0,0,1,255,255,255,255,255,255,255,255,255,255,255,255,0,1,255,255,255,255,255,255,255,255,255,255,255,251,0,0,68,68,68,68,68,68,68,68,68,68,175,243,0,0,0,0,0,0,0,0,0,0,0,1,239,160,0,0,0,0,0,0,0,0,0,0,0,8,255,32,0,0,0,0,0,0,0,0,0,0,0,47,248,0,0,0,0,0,0,0,0,0,0,0,0,159,225,0,0,0,0,0,0,0,0,0,0,0,2,255,128,0,0,0,0,0,0,0,0,0,0,0,10,254,16,0,0,0,0,0,0,0,0,0,0,0,63,247,0,0,0,0,0,0,0,0,0,0,0,0,191,225,0,0,0,0,0,0,0,0,0,0,0,4,255,112,0,0,0,0,0,0,0,0,0,0,0,12,254,16,0,0,0,0,0,0,0,0,0,0,0,79,247,0,0,0,0,0,0,0,0,0,0,0,0,191,225,0,0,0,0,0,0,0,0,0,0,0,4,255,112,0,0,0,0,0,0,0,0,0,0,0,11,254,16,0,0,0,0,0,0,0,0,0,0,0,47,249,0,0,0,0,0,0,0,0,0,0,0,0,159,242,0,0,0,0,0,0,0,0,0,0,0,1,255,160,0,0,0,0,0,0,0,0,0,0,0,7,255,64,0,0,0,0,0,0,0,0,0,0,0,13,253,0,0,0,0,0,0,0,0,0,0,0,0,79,247,0,0,0,0,0,0,0,0,0,0,0,0,175,241,0,0,0,0,0,0,0,0,0,0,0,1,255,160,0,0,0,0,0,0,0,0,0,0,0,6,255,80,0,0,0,0,0,0,0,0,0,0,0,11,254,16,0,0,0,0,0,0,0,0,0,0,0,31,250,0,0,0,0,0,0,0,0,0,0,0,0,111,245,0,0,0,0,0,0,0,0,0,0,0,0,191,241,0,0,0,0,0,0,0,0,0,0,0,1,255,176,0,0,0,0,0,0,0,0,0,0,0,4,255,112,0,0,0,0,0,0,0,0,0,0,0,8,255,48,0,0,0,0,0,0,0,0,0,0,0,13,254,0,0,0,0,0,0,0,0,0,0,0,0,31,251,0,0,0,0,0,0,0,0,0,0,0,0,79,248,0,0,0,0,0,0,0,0,0,0,0,0,127,245,0,0,0,0,0,0,0,0,0,0,0,0,175,242,0,0,0,0,0,0,0,0,0,0,0,0,223,224,0,0,0,0,0,0,0,0,0,0,0,0,0,73,206,254,200,64,0,0,0,0,0,0,0,0,5,223,255,255,255,255,196,0,0,0,0,0,0,0,8,255,253,134,86,157,255,247,0,0,0,0,0,0,8,255,229,0,0,0,6,239,247,0,0,0,0,0,4,255,210,0,0,0,0,3,239,243,0,0,0,0,0,223,243,0,0,0,0,0,4,255,192,0,0,0,0,79,249,0,0,0,0,0,0,10,255,48,0,0,0,8,255,48,0,0,0,0,0,0,95,247,0,0,0,0,175,240,0,0,0,0,0,0,1,255,144,0,0,0,11,254,0,0,0,0,0,0,0,15,250,0,0,0,0,191,240,0,0,0,0,0,0,1,255,160,0,0,0,8,255,32,0,0,0,0,0,0,63,247,0,0,0,0,63,247,0,0,0,0,0,0,9,255,48,0,0,0,0,207,225,0,0,0,0,0,2,255,176,0,0,0,0,3,255,176,0,0,0,0,1,207,243,0,0,0,0,0,5,255,194,0,0,0,2,207,245,0,0,0,0,0,0,5,239,249,65,1,74,255,229,0,0,0,0,0,0,0,2,175,255,255,255,255,145,0,0,0,0,0,0,0,0,58,255,255,255,255,250,48,0,0,0,0,0,0,1,159,255,216,118,121,223,255,144,0,0,0,0,0,1,207,251,48,0,0,0,76,255,177,0,0,0,0,0,207,247,0,0,0,0,0,9,255,176,0,0,0,0,143,247,0,0,0,0,0,0,10,255,112,0,0,0,47,251,0,0,0,0,0,0,0,30,254,16,0,0,7,255,64,0,0,0,0,0,0,0,127,246,0,0,0,207,224,0,0,0,0,0,0,0,2,255,160,0,0,15,250,0,0,0,0,0,0,0,0,13,253,0,0,1,255,144,0,0,0,0,0,0,0,0,191,224,0,0,15,249,0,0,0,0,0,0,0,0,11,254,0,0,0,239,160,0,0,0,0,0,0,0,0,207,208,0,0,12,253,0,0,0,0,0,0,0,0,31,251,0,0,0,143,242,0,0,0,0,0,0,0,5,255,96,0,0,3,255,160,0,0,0,0,0,0,0,207,242,0,0,0,11,255,64,0,0,0,0,0,0,127,249,0,0,0,0,62,254,64,0,0,0,0,0,111,254,32,0,0,0,0,95,255,129,0,0,0,2,175,255,64,0,0,0,0,0,94,255,234,101,69,123,255,254,64,0,0,0,0,0,0,41,255,255,255,255,255,249,16,0,0,0,0,0,0,0,2,106,222,254,218,97,0,0,0,0,0,0,0,0,0,0,72,205,254,217,64,0,0,0,0,0,0,0,0,5,223,255,255,255,255,195,0,0,0,0,0,0,0,26,255,252,118,87,174,255,246,0,0,0,0,0,0,28,255,179,0,0,0,24,255,245,0,0,0,0,0,10,255,128,0,0,0,0,4,255,226,0,0,0,0,6,255,144,0,0,0,0,0,5,255,160,0,0,0,0,223,208,0,0,0,0,0,0,10,255,32,0,0,0,95,246,0,0,0,0,0,0,0,47,248,0,0,0,9,254,0,0,0,0,0,0,0,0,191,208,0,0,0,239,176,0,0,0,0,0,0,0,7,255,32,0,0,31,248,0,0,0,0,0,0,0,0,63,246,0,0,2,255,112,0,0,0,0,0,0,0,1,255,128,0,0,63,247,0,0,0,0,0,0,0,0,15,251,0,0,2,255,128,0,0,0,0,0,0,0,0,255,192,0,0,31,251,0,0,0,0,0,0,0,0,47,253,0,0,0,223,224,0,0,0,0,0,0,0,5,255,224,0,0,9,255,64,0,0,0,0,0,0,0,191,255,0,0,0,63,251,0,0,0,0,0,0,0,79,255,240,0,0,0,191,246,0,0,0,0,0,0,45,234,254,0,0,0,3,239,245,0,0,0,0,0,45,246,175,224,0,0,0,6,255,249,16,0,0,0,126,250,11,253,0,0,0,0,5,255,255,183,85,105,239,250,0,207,192,0,0,0,0,3,191,255,255,255,255,231,0,13,250,0,0,0,0,0,0,56,206,254,218,97,0,0,255,128,0,0,0,0,0,0,0,0,0,0,0,0,47,246,0,0,0,0,0,0,0,0,0,0,0,0,5,255,48,0,0,0,0,0,0,0,0,0,0,0,0,159,224,0,0,0,0,0,0,0,0,0,0,0,0,13,250,0,0,0,0,0,0,0,0,0,0,0,0,3,255,96,0,0,0,0,0,0,0,0,0,0,0,0,159,225,0,0,0,0,0,0,0,0,0,0,0,0,30,249,0,0,0,0,0,0,0,0,0,0,0,0,9,255,32,0,0,0,0,0,0,0,0,0,0,0,5,255,128,0,0,0,0,0,0,0,0,0,0,0,3,239,193,0,0,0,0,0,0,0,0,0,0,0,5,239,226,0,0,0,0,0,1,97,0,0,0,0,59,255,227,0,0,0,0,0,0,47,251,134,85,105,223,255,194,0,0,0,0,0,0,2,255,255,255,255,255,253,96,0,0,0,0,0,0,0,3,122,206,254,219,132,0,0,0,0,0,0,0,0,0,77,233,0,0,0,0,223,255,80,0,0,0,223,255,80,0,0,0,77,233,0,0,0,0,0,0,0,0,0,0,0,0,0,0,0,0,0,0,0,0,0,0,0,0,0,0,0,0,0,0,0,0,0,0,0,0,0,0,0,0,0,0,0,0,0,0,0,0,0,0,0,0,0,0,0,0,0,0,0,0,0,0,0,0,0,0,0,0,0,0,0,0,0,0,0,0,0,0,0,0,0,0,0,0,0,0,0,0,0,0,0,0,0,0,0,0,0,0,0,0,0,0,0,0,0,0,0,0,0,0,0,0,0,0,0,0,0,0,0,0,0,0,0,0,0,0,0,0,0,0,77,233,0,0,0,0,223,255,80,0,0,0,223,255,80,0,0,0,77,233,0,0
};
static const StrandGlyph StrandClockGlyphs[] PROGMEM={
{0,0,0,0,0,0},
{0,0,0,0,0,0},
{0,0,0,0,0,0},
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{5865,0,0,0,0,0}
};
const StrandFont StrandClock={StrandClockBits,StrandClockGlyphs,59};
