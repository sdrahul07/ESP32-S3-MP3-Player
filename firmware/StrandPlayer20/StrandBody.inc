static const uint8_t StrandBodyBits[] PROGMEM={
6,224,0,110,0,5,208,0,93,0,5,208,0,76,0,4,192,0,0,0,0,0,0,109,16,6,209,0,11,98,240,11,98,240,11,98,240,11,98,240,0,0,0,0,0,0,0,0,0,0,0,0,0,0,0,0,0,0,0,0,0,0,5,160,89,0,0,8,112,150,0,0,12,48,195,0,28,223,205,252,192,0,60,3,176,0,0,105,7,128,0,140,238,206,236,96,0,195,13,32,0,1,224,45,0,0,4,176,90,0,0,0,0,0,0,0,0,0,192,0,0,5,207,234,0,4,229,212,144,0,170,12,0,0,10,176,192,0,0,63,172,0,0,0,59,248,16,0,0,14,221,16,0,0,193,215,0,0,12,11,144,8,99,214,243,0,92,239,180,0,0,0,192,0,0,0,12,0,0,4,205,161,0,12,80,1,226,9,128,7,160,0,75,0,76,2,209,0,5,176,4,176,182,0,0,46,32,167,107,0,0,0,93,217,45,39,221,112,0,0,11,101,193,29,48,0,5,176,150,0,151,0,1,210,10,96,9,96,0,167,0,107,1,210,0,92,0,0,157,213,0,0,9,238,178,0,0,0,8,194,43,160,0,0,0,183,0,109,0,229,0,7,193,44,112,13,64,0,12,238,80,0,243,0,27,198,189,48,62,0,10,160,0,126,57,128,0,245,0,0,141,226,0,15,96,0,2,251,0,0,158,98,55,233,232,50,0,125,238,180,4,223,96,11,96,11,96,11,96,11,96,0,0,0,0,0,0,0,0,0,0,0,0,0,0,0,12,80,7,160,1,227,0,92,0,9,128,0,197,0,13,64,0,212,0,12,80,0,168,0,6,176,0,30,32,0,138,0,0,197,122,0,0,197,0,5,192,0,14,48,0,167,0,8,160,0,107,0,6,176,0,122,0,10,112,0,228,0,93,0,12,96,7,160,0,0,45,0,3,199,200,192,3,175,98,0,45,107,0,6,96,163,0,0,0,0,0,0,0,0,0,0,0,0,0,0,0,0,0,0,0,0,0,0,0,0,15,0,0,0,0,0,240,0,0,0,0,15,0,0,0,63,255,255,255,32,0,17,31,17,16,0,0,0,240,0,0,0,0,15,0,0,0,0,0,16,0,0,13,82,225,90,9,96,13,255,246,0,0,0,0,0,0,0,0,0,0,0,0,13,96,214,0,0,1,242,0,0,7,176,0,0,13,80,0,0,93,0,0,0,183,0,0,2,242,0,0,8,160,0,0,14,64,0,0,93,0,0,0,198,0,0,3,225,0,0,9,144,0,0,30,48,0,0,0,109,252,64,0,94,82,143,32,13,112,0,201,2,243,0,8,192,79,16,0,110,5,240,0,5,224,79,0,0,110,3,242,0,8,192,14,96,0,199,0,126,82,142,16,0,126,251,32,0,0,1,138,0,0,24,238,160,0,3,180,154,0,0,0,9,160,0,0,0,154,0,0,0,9,160,0,0,0,154,0,0,0,9,160,0,0,0,154,0,0,0,9,160,0,0,0,154,0,0,3,190,235,32,0,134,35,173,16,0,0,1,244,0,0,0,31,64,0,0,6,225,0,0,4,229,0,0,8,228,0,0,11,177,0,0,9,176,0,0,0,246,34,34,32,47,255,255,252,0,4,206,233,16,0,117,36,219,0,0,0,5,240,0,0,0,110,0,0,1,77,96,0,14,255,128,0,0,18,75,193,0,0,0,14,80,0,0,0,230,0,180,35,189,16,9,223,217,16,0,0,0,30,160,0,0,9,250,0,0,3,218,160,0,1,212,154,0,0,169,9,160,0,140,0,154,0,109,16,9,160,13,255,255,255,241,35,51,58,179,0,0,0,154,0,0,0,9,160,0,2,255,255,241,0,63,34,34,0,4,208,0,0,0,108,0,0,0,7,255,218,32,0,18,36,206,16,0,0,1,230,0,0,0,12,128,0,0,1,230,0,133,36,188,0,7,223,217,16,0,0,7,223,211,0,10,196,39,64,5,225,0,0,0,184,0,0,0,15,123,237,112,1,253,98,110,112,31,112,0,141,0,245,0,6,224,12,144,0,140,0,79,98,110,64,0,93,253,80,0,79,255,255,253,1,34,34,45,112,0,0,5,208,0,0,0,214,0,0,0,94,0,0,0,12,112,0,0,3,241,0,0,0,155,0,0,0,14,96,0,0,3,242,0,0,0,110,0,0,0,0,109,235,48,0,94,82,142,32,11,144,0,230,0,185,0,13,96,4,228,24,209,0,9,255,245,0,10,195,21,229,3,243,0,8,208,79,48,0,142,0,204,67,111,128,1,157,237,112,0,0,125,252,48,0,157,66,158,32,31,64,0,200,4,241,0,9,176,47,64,0,188,0,189,83,142,192,1,158,233,155,0,0,0,11,112,0,0,3,242,0,132,37,232,0,6,239,198,0,0,13,96,214,0,0,0,0,0,0,13,96,214,13,112,215,0,0,0,0,0,0,13,82,225,90,9,96,0,0,0,5,160,0,0,0,76,180,0,0,4,188,64,0,0,10,246,0,0,0,0,24,217,32,0,0,0,1,125,163,0,0,0,0,6,160,0,0,0,0,0,0,3,255,255,255,242,0,0,0,0,0,0,0,0,0,0,0,0,63,255,255,255,32,0,0,0,0,0,0,0,0,0,0,0,0,0,0,0,0,0,0,164,0,0,0,0,4,204,64,0,0,0,0,76,179,0,0,0,0,6,249,0,0,0,41,216,16,0,4,173,113,0,0,0,165,0,0,0,0,0,0,0,0,0,7,222,214,0,180,38,243,0,0,14,64,0,8,176,0,9,161,0,6,192,0,0,123,0,0,0,0,0,0,0,0,0,5,225,0,0,94,16,0,0,0,57,221,220,129,0,0,0,125,81,0,39,212,0,0,124,16,0,0,3,227,0,30,32,43,220,181,7,160,6,160,30,96,47,48,62,0,151,6,176,0,226,2,224,9,112,137,0,47,0,91,0,137,5,209,25,227,28,64,3,225,9,237,87,237,96,0,10,160,0,0,0,0,0,0,27,196,16,3,161,0,0,0,5,189,238,199,0,0,0,0,190,16,0,0,0,46,198,0,0,0,8,167,192,0,0,0,213,47,48,0,0,79,16,201,0,0,10,160,6,225,0,1,245,0,31,96,0,127,255,255,252,0,13,163,51,55,242,4,243,0,0,14,128,173,0,0,0,142,0,8,255,253,128,0,140,51,127,112,8,192,0,171,0,140,0,10,160,8,192,22,227,0,143,255,248,0,8,195,53,204,0,140,0,2,244,8,192,0,47,80,140,51,92,209,8,255,253,146,0,0,4,174,253,145,0,143,148,53,177,6,244,0,0,0,13,128,0,0,0,47,64,0,0,0,79,32,0,0,0,63,48,0,0,0,14,112,0,0,0,9,227,0,0,0,1,206,132,54,177,0,7,206,236,128,8,255,254,200,16,0,140,51,71,222,48,8,192,0,1,205,0,140,0,0,3,244,8,192,0,0,14,96,140,0,0,0,231,8,192,0,0,15,80,140,0,0,5,242,8,192,0,2,217,0,140,51,72,235,0,8,255,254,181,0,0,8,255,255,242,8,195,51,48,8,192,0,0,8,192,0,0,8,192,0,0,8,255,255,192,8,195,51,32,8,192,0,0,8,192,0,0,8,195,51,49,8,255,255,246,8,255,255,242,8,195,51,48,8,192,0,0,8,192,0,0,8,192,0,0,8,255,255,192,8,195,51,32,8,192,0,0,8,192,0,0,8,192,0,0,8,192,0,0,0,3,174,254,181,0,7,249,67,88,128,5,244,0,0,0,0,216,0,0,0,0,47,48,0,0,0,4,242,0,14,255,208,63,48,0,51,157,0,231,0,0,7,208,8,226,0,0,125,0,11,232,67,92,208,0,6,206,236,147,0,8,192,0,0,109,0,140,0,0,6,208,8,192,0,0,109,0,140,0,0,6,208,8,192,0,0,109,0,143,255,255,255,208,8,195,51,51,141,0,140,0,0,6,208,8,192,0,0,109,0,140,0,0,6,208,8,192,0,0,109,0,8,192,8,192,8,192,8,192,8,192,8,192,8,192,8,192,8,192,8,192,8,192,0,15,80,0,15,80,0,15,80,0,15,80,0,15,80,0,15,80,0,15,80,0,15,64,0,63,32,20,203,0,207,177,0,8,192,0,62,112,8,192,2,217,0,8,192,28,160,0,8,192,187,0,0,8,201,193,0,0,8,239,96,0,0,8,199,244,0,0,8,192,158,48,0,8,192,11,210,0,8,192,1,205,16,8,192,0,45,193,8,192,0,0,8,192,0,0,8,192,0,0,8,192,0,0,8,192,0,0,8,192,0,0,8,192,0,0,8,192,0,0,8,192,0,0,8,195,51,49,8,255,255,244,8,246,0,0,0,30,208,8,236,0,0,0,110,208,8,190,64,0,0,203,208,8,184,160,0,4,214,208,8,178,225,0,10,118,208,8,176,167,0,30,22,208,8,176,61,0,136,6,208,8,176,11,80,210,6,208,8,176,4,181,144,6,208,8,176,0,204,48,6,208,8,176,0,107,0,6,208,8,247,0,0,12,128,8,239,48,0,12,128,8,202,192,0,12,128,8,194,231,0,12,128,8,192,110,32,12,128,8,192,11,176,12,128,8,192,2,230,12,128,8,192,0,110,44,128,8,192,0,11,172,128,8,192,0,2,238,128,8,192,0,0,127,128,0,6,206,253,113,0,0,190,132,54,220,16,7,227,0,0,29,144,14,128,0,0,6,241,63,48,0,0,2,244,79,32,0,0,1,245,63,48,0,0,2,243,14,112,0,0,6,225,8,226,0,0,29,144,0,190,115,55,236,16,0,7,206,236,112,0,8,255,253,129,0,140,51,109,176,8,192,0,79,32,140,0,1,244,8,192,0,79,48,140,1,77,176,8,255,255,161,0,140,51,16,0,8,192,0,0,0,140,0,0,0,8,192,0,0,0,0,6,206,253,113,0,0,10,232,67,109,193,0,7,227,0,0,29,144,0,232,0,0,0,111,16,63,48,0,0,2,244,4,242,0,0,0,31,80,63,48,0,0,2,243,0,231,0,0,0,110,16,8,226,0,0,29,144,0,11,231,51,126,193,0,0,7,206,236,250,32,0,0,0,0,3,190,112,8,255,254,162,0,8,195,53,221,0,8,192,0,79,48,8,192,0,95,16,8,195,54,232,0,8,255,254,80,0,8,192,44,176,0,8,192,2,230,0,8,192,0,126,16,8,192,0,29,144,8,192,0,5,243,0,108,238,194,0,158,99,89,64,15,96,0,0,0,217,0,0,0,5,250,32,0,0,3,191,161,0,0,0,76,226,0,0,0,29,144,0,0,0,186,1,182,52,143,80,11,239,235,80,0,175,255,255,255,18,51,141,51,48,0,7,208,0,0,0,125,0,0,0,7,208,0,0,0,125,0,0,0,7,208,0,0,0,125,0,0,0,7,208,0,0,0,125,0,0,0,7,208,0,0,10,160,0,0,170,0,170,0,0,10,160,10,160,0,0,170,0,170,0,0,10,160,10,160,0,0,170,0,170,0,0,10,160,10,160,0,0,170,0,155,0,0,11,144,6,242,0,2,245,0,29,214,53,220,0,0,42,239,217,16,0,172,0,0,0,201,95,32,0,2,243,14,112,0,7,208,9,192,0,12,112,3,242,0,47,32,0,199,0,139,0,0,124,0,213,0,0,47,35,224,0,0,11,120,144,0,0,5,205,48,0,0,1,237,0,0,172,0,0,47,96,0,12,149,241,0,7,250,0,1,245,31,80,0,187,224,0,95,16,186,0,31,79,48,9,176,7,224,5,208,199,0,215,0,47,48,169,8,192,47,48,0,215,14,80,79,22,208,0,8,195,241,0,229,169,0,0,79,139,0,10,158,80,0,0,238,112,0,110,241,0,0,10,242,0,2,251,0,0,63,96,0,10,192,8,225,0,79,48,1,217,1,216,0,0,79,56,209,0,0,10,207,64,0,0,3,252,0,0,0,11,191,80,0,0,110,24,209,0,2,230,1,217,0,12,176,0,95,64,127,32,0,10,208,157,0,0,13,114,245,0,6,225,9,192,0,214,0,30,80,109,0,0,140,13,96,0,1,233,208,0,0,8,245,0,0,0,79,16,0,0,4,241,0,0,0,79,16,0,0,4,241,0,0,63,255,255,255,145,51,51,57,209,0,0,3,244,0,0,0,201,0,0,0,141,16,0,0,63,48,0,0,29,128,0,0,9,192,0,0,4,226,0,0,1,217,51,51,50,159,255,255,255,144,7,254,96,123,0,7,176,0,123,0,7,176,0,123,0,7,176,0,123,0,7,176,0,123,0,7,176,0,123,0,7,176,0,127,230,30,48,0,0,9,144,0,0,3,225,0,0,0,198,0,0,0,108,0,0,0,30,48,0,0,9,144,0,0,3,225,0,0,0,182,0,0,0,92,0,0,0,14,48,0,0,8,144,0,0,2,225,142,244,0,13,64,0,212,0,13,64,0,212,0,13,64,0,212,0,13,64,0,212,0,13,64,0,212,0,13,64,0,212,8,239,64,0,0,61,0,0,0,0,11,231,0,0,0,4,210,226,0,0,0,197,8,160,0,0,108,0,13,64,0,29,48,0,93,0,0,0,0,0,0,0,0,0,0,0,0,0,0,0,0,0,0,0,0,0,0,0,0,0,0,0,0,0,0,0,0,14,238,238,233,30,64,5,192,0,166,0,0,0,0,0,0,0,0,0,0,0,0,0,0,0,0,0,0,0,0,3,174,235,32,7,115,43,176,0,0,5,224,1,122,222,240,29,181,53,240,79,16,6,240,47,114,93,240,6,222,165,240,11,144,0,0,0,185,0,0,0,11,144,0,0,0,185,0,0,0,11,150,223,196,0,189,163,42,225,11,208,0,13,112,185,0,0,185,11,144,0,11,128,188,0,1,229,11,232,35,189,0,185,142,234,32,0,92,254,128,111,114,72,14,112,0,3,242,0,0,63,32,0,1,246,0,0,8,230,36,128,7,223,214,0,0,0,47,32,0,0,2,242,0,0,0,47,32,0,0,2,242,0,125,252,95,32,126,98,93,242,14,96,0,95,34,242,0,2,242,63,32,0,63,33,245,0,6,242,9,229,37,207,32,25,238,164,242,0,109,236,80,7,212,38,243,30,64,0,169,63,255,255,251,63,49,17,17,31,96,0,0,8,230,35,146,0,142,253,129,0,76,227,0,232,16,3,241,0,3,241,0,159,255,224,20,242,16,3,241,0,3,241,0,3,241,0,3,241,0,3,241,0,3,241,0,0,125,252,95,32,126,98,93,242,14,96,0,95,34,242,0,2,242,63,32,0,63,33,245,0,6,242,9,229,38,207,32,25,238,164,242,0,0,0,79,16,0,0,9,192,8,98,56,245,0,92,238,197,0,11,144,0,0,0,185,0,0,0,11,144,0,0,0,185,0,0,0,11,150,222,161,0,189,146,78,144,11,192,0,125,0,185,0,5,224,11,144,0,94,0,185,0,5,224,11,144,0,94,0,185,0,5,224,10,144,10,144,0,0,0,0,11,144,11,144,11,144,11,144,11,144,11,144,11,144,11,144,0,10,144,0,10,144,0,0,0,0,0,0,0,11,144,0,11,144,0,11,144,0,11,144,0,11,144,0,11,144,0,11,144,0,11,144,0,11,128,0,13,80,2,142,16,127,196,0,11,144,0,0,11,144,0,0,11,144,0,0,11,144,0,0,11,144,7,227,11,144,110,64,11,149,228,0,11,207,80,0,11,190,128,0,11,147,232,0,11,144,79,112,11,144,5,247,11,144,11,144,11,144,11,144,11,144,11,144,11,144,11,144,11,144,11,144,11,144,11,144,11,151,238,128,142,232,0,11,231,38,251,130,95,80,11,192,0,205,0,11,144,11,144,0,170,0,10,160,11,144,0,169,0,9,160,11,144,0,169,0,9,160,11,144,0,169,0,9,160,11,144,0,169,0,9,160,11,150,222,161,0,189,146,78,144,11,192,0,125,0,185,0,5,224,11,144,0,94,0,185,0,5,224,11,144,0,94,0,185,0,5,224,0,108,254,162,0,126,98,59,208,30,96,0,30,99,242,0,0,184,63,32,0,11,145,246,0,1,229,8,230,35,188,0,7,223,233,16,11,150,223,196,0,189,163,42,225,11,208,0,13,112,185,0,0,185,11,144,0,11,128,188,0,1,229,11,232,35,189,0,185,142,234,32,11,144,0,0,0,185,0,0,0,11,144,0,0,0,185,0,0,0,0,125,252,95,32,126,82,93,242,14,96,0,95,34,242,0,2,242,63,32,0,63,33,245,0,6,242,9,229,38,207,32,25,238,164,242,0,0,0,47,32,0,0,2,242,0,0,0,47,32,0,0,2,242,11,152,231,11,215,0,11,192,0,11,144,0,11,144,0,11,144,0,11,144,0,11,144,0,3,190,232,0,232,36,144,47,64,0,0,159,147,0,0,58,248,0,0,5,241,57,50,142,1,190,235,48,3,208,0,4,240,0,175,255,240,21,241,16,4,240,0,4,240,0,4,240,0,4,240,0,2,245,16,0,142,224,13,96,0,140,0,214,0,8,192,13,96,0,140,0,214,0,8,192,13,96,0,140,0,200,0,11,192,8,229,39,236,0,25,238,136,192,186,0,0,230,95,16,4,225,14,80,10,144,9,160,30,48,3,241,92,0,0,198,182,0,0,106,225,0,0,30,144,0,170,0,12,160,1,243,94,0,46,224,4,224,31,48,105,227,8,144,11,112,180,167,13,80,7,193,224,91,47,16,2,246,160,31,107,0,0,221,80,12,214,0,0,143,16,7,242,0,95,32,9,192,11,160,62,48,2,227,183,0,0,126,192,0,0,95,176,0,2,228,214,0,11,144,94,32,126,16,10,176,186,0,0,215,95,16,3,241,14,80,8,160,8,160,13,64,2,241,61,0,0,181,151,0,0,90,210,0,0,14,160,0,0,14,64,0,0,93,0,0,3,214,0,0,158,128,0,0,79,255,255,176,17,22,226,0,2,229,0,0,185,0,0,125,16,0,62,48,0,29,129,17,25,255,255,252,0,93,80,14,96,1,242,0,31,16,1,241,0,109,0,79,80,0,109,0,1,241,0,31,16,1,241,0,31,32,0,214,0,4,213,10,128,10,128,10,128,10,128,10,128,10,128,10,128,10,128,10,128,10,128,10,128,10,128,10,128,10,128,10,128,10,128,124,48,0,139,0,4,224,0,78,0,3,224,0,30,64,0,127,32,30,64,3,224,0,78,0,4,224,0,77,0,8,160,7,194,0,0,142,216,33,211,0,61,35,158,249,0,0,0,0,0,0,0,0,0,0,0,0,0,0,0,0,0,0,0,0,0,0,0,11,255,255,255,240,11,112,0,2,240,11,112,0,2,240,11,112,0,2,240,11,112,0,2,240,11,112,0,2,240,11,112,0,2,240,11,112,0,2,240,11,112,0,2,240,11,112,0,2,240,11,255,255,255,240,11,255,255,255,240,11,112,0,2,240,11,112,0,2,240,11,112,0,2,240,11,112,0,2,240,11,112,0,2,240,11,112,0,2,240,11,112,0,2,240,11,112,0,2,240,11,112,0,2,240,11,255,255,255,240,11,255,255,255,240,11,112,0,2,240,11,112,0,2,240,11,112,0,2,240,11,112,0,2,240,11,112,0,2,240,11,112,0,2,240,11,112,0,2,240,11,112,0,2,240,11,112,0,2,240,11,255,255,255,240,11,255,255,255,240,11,112,0,2,240,11,112,0,2,240,11,112,0,2,240,11,112,0,2,240,11,112,0,2,240,11,112,0,2,240,11,112,0,2,240,11,112,0,2,240,11,112,0,2,240,11,255,255,255,240,11,255,255,255,240,11,112,0,2,240,11,112,0,2,240,11,112,0,2,240,11,112,0,2,240,11,112,0,2,240,11,112,0,2,240,11,112,0,2,240,11,112,0,2,240,11,112,0,2,240,11,255,255,255,240,11,255,255,255,240,11,112,0,2,240,11,112,0,2,240,11,112,0,2,240,11,112,0,2,240,11,112,0,2,240,11,112,0,2,240,11,112,0,2,240,11,112,0,2,240,11,112,0,2,240,11,255,255,255,240,11,255,255,255,240,11,112,0,2,240,11,112,0,2,240,11,112,0,2,240,11,112,0,2,240,11,112,0,2,240,11,112,0,2,240,11,112,0,2,240,11,112,0,2,240,11,112,0,2,240,11,255,255,255,240,11,255,255,255,240,11,112,0,2,240,11,112,0,2,240,11,112,0,2,240,11,112,0,2,240,11,112,0,2,240,11,112,0,2,240,11,112,0,2,240,11,112,0,2,240,11,112,0,2,240,11,255,255,255,240,11,255,255,255,240,11,112,0,2,240,11,112,0,2,240,11,112,0,2,240,11,112,0,2,240,11,112,0,2,240,11,112,0,2,240,11,112,0,2,240,11,112,0,2,240,11,112,0,2,240,11,255,255,255,240,11,255,255,255,240,11,112,0,2,240,11,112,0,2,240,11,112,0,2,240,11,112,0,2,240,11,112,0,2,240,11,112,0,2,240,11,112,0,2,240,11,112,0,2,240,11,112,0,2,240,11,255,255,255,240,11,255,255,255,240,11,112,0,2,240,11,112,0,2,240,11,112,0,2,240,11,112,0,2,240,11,112,0,2,240,11,112,0,2,240,11,112,0,2,240,11,112,0,2,240,11,112,0,2,240,11,255,255,255,240,11,255,255,255,240,11,112,0,2,240,11,112,0,2,240,11,112,0,2,240,11,112,0,2,240,11,112,0,2,240,11,112,0,2,240,11,112,0,2,240,11,112,0,2,240,11,112,0,2,240,11,255,255,255,240,11,255,255,255,240,11,112,0,2,240,11,112,0,2,240,11,112,0,2,240,11,112,0,2,240,11,112,0,2,240,11,112,0,2,240,11,112,0,2,240,11,112,0,2,240,11,112,0,2,240,11,255,255,255,240,11,255,255,255,240,11,112,0,2,240,11,112,0,2,240,11,112,0,2,240,11,112,0,2,240,11,112,0,2,240,11,112,0,2,240,11,112,0,2,240,11,112,0,2,240,11,112,0,2,240,11,255,255,255,240,11,255,255,255,240,11,112,0,2,240,11,112,0,2,240,11,112,0,2,240,11,112,0,2,240,11,112,0,2,240,11,112,0,2,240,11,112,0,2,240,11,112,0,2,240,11,112,0,2,240,11,255,255,255,240,11,255,255,255,240,11,112,0,2,240,11,112,0,2,240,11,112,0,2,240,11,112,0,2,240,11,112,0,2,240,11,112,0,2,240,11,112,0,2,240,11,112,0,2,240,11,112,0,2,240,11,255,255,255,240,11,255,255,255,240,11,112,0,2,240,11,112,0,2,240,11,112,0,2,240,11,112,0,2,240,11,112,0,2,240,11,112,0,2,240,11,112,0,2,240,11,112,0,2,240,11,112,0,2,240,11,255,255,255,240,11,255,255,255,240,11,112,0,2,240,11,112,0,2,240,11,112,0,2,240,11,112,0,2,240,11,112,0,2,240,11,112,0,2,240,11,112,0,2,240,11,112,0,2,240,11,112,0,2,240,11,255,255,255,240,11,255,255,255,240,11,112,0,2,240,11,112,0,2,240,11,112,0,2,240,11,112,0,2,240,11,112,0,2,240,11,112,0,2,240,11,112,0,2,240,11,112,0,2,240,11,112,0,2,240,11,255,255,255,240,11,255,255,255,240,11,112,0,2,240,11,112,0,2,240,11,112,0,2,240,11,112,0,2,240,11,112,0,2,240,11,112,0,2,240,11,112,0,2,240,11,112,0,2,240,11,112,0,2,240,11,255,255,255,240,11,255,255,255,240,11,112,0,2,240,11,112,0,2,240,11,112,0,2,240,11,112,0,2,240,11,112,0,2,240,11,112,0,2,240,11,112,0,2,240,11,112,0,2,240,11,112,0,2,240,11,255,255,255,240,11,255,255,255,240,11,112,0,2,240,11,112,0,2,240,11,112,0,2,240,11,112,0,2,240,11,112,0,2,240,11,112,0,2,240,11,112,0,2,240,11,112,0,2,240,11,112,0,2,240,11,255,255,255,240,11,255,255,255,240,11,112,0,2,240,11,112,0,2,240,11,112,0,2,240,11,112,0,2,240,11,112,0,2,240,11,112,0,2,240,11,112,0,2,240,11,112,0,2,240,11,112,0,2,240,11,255,255,255,240,11,255,255,255,240,11,112,0,2,240,11,112,0,2,240,11,112,0,2,240,11,112,0,2,240,11,112,0,2,240,11,112,0,2,240,11,112,0,2,240,11,112,0,2,240,11,112,0,2,240,11,255,255,255,240,11,255,255,255,240,11,112,0,2,240,11,112,0,2,240,11,112,0,2,240,11,112,0,2,240,11,112,0,2,240,11,112,0,2,240,11,112,0,2,240,11,112,0,2,240,11,112,0,2,240,11,255,255,255,240,11,255,255,255,240,11,112,0,2,240,11,112,0,2,240,11,112,0,2,240,11,112,0,2,240,11,112,0,2,240,11,112,0,2,240,11,112,0,2,240,11,112,0,2,240,11,112,0,2,240,11,255,255,255,240,11,255,255,255,240,11,112,0,2,240,11,112,0,2,240,11,112,0,2,240,11,112,0,2,240,11,112,0,2,240,11,112,0,2,240,11,112,0,2,240,11,112,0,2,240,11,112,0,2,240,11,255,255,255,240,11,255,255,255,240,11,112,0,2,240,11,112,0,2,240,11,112,0,2,240,11,112,0,2,240,11,112,0,2,240,11,112,0,2,240,11,112,0,2,240,11,112,0,2,240,11,112,0,2,240,11,255,255,255,240,11,255,255,255,240,11,112,0,2,240,11,112,0,2,240,11,112,0,2,240,11,112,0,2,240,11,112,0,2,240,11,112,0,2,240,11,112,0,2,240,11,112,0,2,240,11,112,0,2,240,11,255,255,255,240,11,255,255,255,240,11,112,0,2,240,11,112,0,2,240,11,112,0,2,240,11,112,0,2,240,11,112,0,2,240,11,112,0,2,240,11,112,0,2,240,11,112,0,2,240,11,112,0,2,240,11,255,255,255,240,11,255,255,255,240,11,112,0,2,240,11,112,0,2,240,11,112,0,2,240,11,112,0,2,240,11,112,0,2,240,11,112,0,2,240,11,112,0,2,240,11,112,0,2,240,11,112,0,2,240,11,255,255,255,240,11,255,255,255,240,11,112,0,2,240,11,112,0,2,240,11,112,0,2,240,11,112,0,2,240,11,112,0,2,240,11,112,0,2,240,11,112,0,2,240,11,112,0,2,240,11,112,0,2,240,11,255,255,255,240,11,255,255,255,240,11,112,0,2,240,11,112,0,2,240,11,112,0,2,240,11,112,0,2,240,11,112,0,2,240,11,112,0,2,240,11,112,0,2,240,11,112,0,2,240,11,112,0,2,240,11,255,255,255,240,6,209,0,109,16,0,0,0,0,0,4,192,0,77,0,4,208,0,93,0,5,224,0,94,0,5,224,0,0,0,75,0,0,0,4,176,0,0,7,223,212,0,9,217,198,96,3,243,75,0,0,124,4,176,0,8,192,75,0,0,95,36,176,0,0,204,139,101,0,1,158,252,48,0,0,75,0,0,0,3,206,210,0,1,232,38,48,0,94,0,0,0,7,192,0,0,0,124,0,0,0,255,255,242,0,2,141,34,0,0,7,192,0,0,0,169,0,0,0,108,33,17,16,63,255,255,253,0,26,0,0,26,0,186,206,203,160,5,228,21,227,0,166,0,8,128,10,96,0,137,0,94,65,94,48,11,189,253,185,1,160,0,1,160,0,0,0,0,0,0,0,0,0,63,64,0,141,0,172,0,30,80,2,244,8,176,0,8,193,227,0,0,30,186,0,0,255,255,255,144,1,21,241,17,0,0,79,0,0,15,255,255,249,0,17,95,17,16,0,4,240,0,0,10,128,10,128,10,128,10,128,10,128,10,128,10,128,0,0,0,0,10,128,10,128,10,128,10,128,10,128,10,128,10,128,0,142,230,0,109,53,160,9,176,4,0,111,96,0,3,255,195,0,201,43,225,14,96,31,64,173,35,243,1,207,218,0,0,127,112,0,0,140,0,148,44,144,8,238,161,0,12,80,197,0,197,12,80,0,0,0,0,0,0,0,0,0,0,0,0,0,0,0,0,0,0,0,0,0,0,0,0,0,0,0,0,0,0,0,0,0,0,0,0,0,90,170,183,16,0,0,26,96,0,4,178,0,0,148,24,223,210,27,16,3,128,187,49,66,4,112,8,34,241,0,0,0,176,10,3,241,0,0,0,160,10,0,202,33,50,0,160,7,48,24,222,194,0,160,2,160,0,0,0,7,80,0,103,0,0,0,74,0,0,6,164,16,57,144,0,0,0,39,170,131,0,0,8,221,144,2,0,180,5,188,230,61,32,166,75,2,230,10,218,182,0,0,0,0,0,0,0,0,0,0,0,0,0,0,0,0,108,22,209,5,209,93,32,30,49,228,0,6,193,93,16,0,108,22,193,0,0,0,0,0,0,0,0,3,255,255,255,242,0,1,17,17,29,32,0,0,0,0,210,0,0,0,0,13,32,0,0,0,0,16,0,0,0,0,0,0,13,255,246,0,0,0,0,0,0,0,0,0,0,0,0,0,0,58,187,181,0,0,0,5,162,0,24,128,0,0,27,11,204,144,133,0,0,101,11,49,225,26,0,0,131,11,222,64,11,0,0,101,11,55,128,26,0,0,43,11,48,210,133,0,0,5,161,0,8,144,0,0,0,58,187,181,0,0,0,0,0,0,0,0,0,0,0,0,0,0,0,0,238,238,238,144,0,0,0,0,0,0,0,0,0,0,0,0,0,0,0,0,0,0,0,0,0,0,0,0,0,0,0,0,0,0,0,0,0,0,0,0,0,0,6,221,96,29,17,209,29,17,209,6,221,96,0,0,0,0,0,0,0,0,0,0,0,0,0,0,0,0,0,0,0,0,0,0,0,1,0,0,0,0,0,240,0,0,0,0,15,0,0,0,1,17,241,17,0,3,255,255,255,242,0,0,0,240,0,0,0,0,15,0,0,0,0,0,240,0,0,0,17,17,17,16,0,63,255,255,255,32,6,222,96,8,36,224,0,7,176,0,156,32,11,128,0,47,255,242,0,0,0,0,0,0,0,0,0,0,0,0,0,0,0,0,0,0,0,0,0,9,238,112,0,6,176,4,238,80,0,3,225,7,3,224,11,237,80,0,0,0,0,0,0,0,0,0,0,0,0,0,0,0,0,0,0,0,0,0,0,123,0,46,32,10,96,0,0,0,0,0,0,0,0,0,0,0,0,0,0,0,0,0,0,0,0,0,0,0,0,0,0,11,144,0,94,0,185,0,5,224,11,144,0,94,0,185,0,5,224,11,144,0,110,0,187,0,9,224,11,247,54,222,0,186,190,180,241,11,144,0,0,0,185,0,0,0,11,144,0,0,0,9,237,222,100,255,117,128,79,247,88,0,159,117,128,0,103,88,0,6,117,128,0,103,88,0,6,117,128,0,103,88,0,6,117,128,0,103,88,0,13,96,214,0,0,0,0,0,0,72,0,59,160,1,240,107,128,4,184,0,88,136,0,0,136,0,0,136,0,0,136,0,0,136,0,0,0,0,0,0,0,0,0,0,0,0,0,0,0,0,0,0,0,0,0,0,4,205,195,1,227,4,225,91,0,13,53,176,0,211,30,48,93,0,76,219,48,0,0,0,0,0,0,0,0,0,0,0,0,0,0,0,0,0,0,28,112,184,0,1,198,28,112,0,47,34,243,1,199,28,112,28,128,184,0,0,0,0,0,0,0,0,0,4,184,0,0,8,144,0,5,136,128,0,2,209,0,0,0,136,0,0,181,0,0,0,8,128,0,91,0,0,0,0,136,0,29,32,0,0,0,8,128,9,128,2,231,0,0,0,3,209,0,173,112,0,0,0,197,0,90,135,0,0,0,107,0,43,24,112,0,0,30,32,9,255,255,80,0,10,112,0,0,8,112,0,4,184,0,0,8,144,0,5,136,128,0,2,209,0,0,0,136,0,0,181,0,0,0,8,128,0,91,0,0,0,0,136,0,29,32,0,0,0,8,128,9,128,27,236,16,0,0,3,209,4,81,167,0,0,0,197,0,0,29,64,0,0,107,0,0,61,112,0,0,30,32,0,77,48,0,0,10,112,0,10,255,250,0,9,238,112,0,1,210,0,0,0,107,0,0,152,0,0,4,238,80,0,61,16,0,0,0,62,16,12,80,0,0,7,3,224,6,160,0,0,0,190,213,1,226,0,143,0,0,0,0,167,0,44,240,0,0,0,77,0,11,63,0,0,0,13,64,9,97,240,0,0,7,160,1,255,255,208,0,2,225,0,0,1,240,0,0,7,192,0,0,124,0,0,0,0,0,0,0,0,0,3,240,0,0,93,0,0,77,48,0,77,32,0,12,112,0,0,188,50,119,2,190,235,48,0,11,112,0,0,0,0,46,32,0,0,0,0,106,0,0,0,0,0,0,0,0,0,0,190,16,0,0,0,46,198,0,0,0,8,167,192,0,0,0,213,47,48,0,0,79,16,201,0,0,10,160,6,225,0,1,245,0,31,96,0,127,255,255,252,0,13,163,51,55,242,4,243,0,0,14,128,173,0,0,0,142,0,0,0,12,112,0,0,0,6,176,0,0,0,1,210,0,0,0,0,0,0,0,0,0,0,190,16,0,0,0,46,198,0,0,0,8,167,192,0,0,0,213,47,48,0,0,79,16,201,0,0,10,160,6,225,0,1,245,0,31,96,0,127,255,255,252,0,13,163,51,55,242,4,243,0,0,14,128,173,0,0,0,142,0,0,0,188,0,0,0,0,90,150,0,0,0,12,17,209,0,0,0,0,0,0,0,0,0,190,16,0,0,0,46,198,0,0,0,8,167,192,0,0,0,213,47,48,0,0,79,16,201,0,0,10,160,6,225,0,1,245,0,31,96,0,127,255,255,252,0,13,163,51,55,242,4,243,0,0,14,128,173,0,0,0,142,0,0,11,196,72,0,0,4,131,190,48,0,0,0,0,0,0,0,0,11,225,0,0,0,2,236,96,0,0,0,138,124,0,0,0,13,82,243,0,0,4,241,12,144,0,0,170,0,110,16,0,31,80,1,246,0,7,255,255,255,192,0,218,51,51,127,32,79,48,0,0,232,10,208,0,0,8,224,0,30,33,226,0,0,1,226,30,32,0,0,0,0,0,0,0,0,11,225,0,0,0,2,236,96,0,0,0,138,124,0,0,0,13,82,243,0,0,4,241,12,144,0,0,170,0,110,16,0,31,80,1,246,0,7,255,255,255,192,0,218,51,51,127,32,79,48,0,0,232,10,208,0,0,8,224,0,2,171,64,0,0,0,118,42,0,0,0,3,239,80,0,0,0,13,211,0,0,0,5,200,160,0,0,0,182,63,16,0,0,47,16,199,0,0,8,176,7,208,0,1,229,0,47,64,0,111,255,255,250,0,12,163,51,55,242,3,243,0,0,14,128,157,0,0,0,142,0,0,0,11,255,255,255,192,0,0,63,94,131,51,32,0,0,171,14,96,0,0,0,3,244,14,96,0,0,0,10,192,14,96,0,0,0,63,80,14,255,255,112,0,173,0,14,131,51,16,3,255,255,255,96,0,0,10,227,51,62,96,0,0,63,96,0,14,131,51,48,173,0,0,14,255,255,240,0,4,174,253,145,0,143,148,53,177,6,244,0,0,0,13,128,0,0,0,47,64,0,0,0,79,32,0,0,0,63,48,0,0,0,14,112,0,0,0,9,227,0,0,0,1,206,132,54,177,0,7,206,236,128,0,0,12,0,0,0,0,8,195,0,0,0,0,151,0,0,0,26,178,0,0,62,16,0,0,8,144,0,0,0,195,0,0,0,0,0,8,255,255,242,8,195,51,48,8,192,0,0,8,192,0,0,8,192,0,0,8,255,255,192,8,195,51,32,8,192,0,0,8,192,0,0,8,195,51,49,8,255,255,246,0,0,93,16,0,0,212,0,0,7,144,0,0,0,0,0,8,255,255,242,8,195,51,48,8,192,0,0,8,192,0,0,8,192,0,0,8,255,255,192,8,195,51,32,8,192,0,0,8,192,0,0,8,195,51,49,8,255,255,246,0,8,226,0,0,44,121,0,0,164,12,48,0,0,0,0,8,255,255,242,8,195,51,48,8,192,0,0,8,192,0,0,8,192,0,0,8,255,255,192,8,195,51,32,8,192,0,0,8,192,0,0,8,195,51,49,8,255,255,246,0,182,11,96,0,182,11,96,0,0,0,0,8,255,255,242,8,195,51,48,8,192,0,0,8,192,0,0,8,192,0,0,8,255,255,192,8,195,51,32,8,192,0,0,8,192,0,0,8,195,51,49,8,255,255,246,124,0,11,96,2,209,0,0,8,192,8,192,8,192,8,192,8,192,8,192,8,192,8,192,8,192,8,192,8,192,0,153,3,209,12,64,0,0,8,192,8,192,8,192,8,192,8,192,8,192,8,192,8,192,8,192,8,192,8,192,0,158,16,3,200,128,11,48,194,0,0,0,0,140,0,0,140,0,0,140,0,0,140,0,0,140,0,0,140,0,0,140,0,0,140,0,0,140,0,0,140,0,0,140,0,13,64,212,13,64,212,0,0,0,0,140,0,0,140,0,0,140,0,0,140,0,0,140,0,0,140,0,0,140,0,0,140,0,0,140,0,0,140,0,0,140,0,8,255,254,200,16,0,140,51,71,222,48,8,192,0,1,205,0,140,0,0,3,244,8,192,0,0,14,108,255,255,96,0,231,58,195,49,0,15,80,140,0,0,5,242,8,192,0,2,217,0,140,51,72,235,0,8,255,254,181,0,0,0,0,188,67,144,0,0,3,147,190,64,0,0,0,0,0,0,0,8,247,0,0,12,128,8,239,48,0,12,128,8,202,192,0,12,128,8,194,231,0,12,128,8,192,110,32,12,128,8,192,11,176,12,128,8,192,2,230,12,128,8,192,0,110,44,128,8,192,0,11,172,128,8,192,0,2,238,128,8,192,0,0,127,128,0,0,199,0,0,0,0,0,46,16,0,0,0,0,7,144,0,0,0,0,0,0,0,0,0,6,206,253,113,0,0,190,132,54,220,16,7,227,0,0,29,144,14,128,0,0,6,241,63,48,0,0,2,244,79,32,0,0,1,245,63,48,0,0,2,243,14,112,0,0,6,225,8,226,0,0,29,144,0,190,115,55,236,16,0,7,206,236,112,0,0,0,0,138,0,0,0,0,2,209,0,0,0,0,11,80,0,0,0,0,0,0,0,0,0,6,206,253,113,0,0,190,132,54,220,16,7,227,0,0,29,144,14,128,0,0,6,241,63,48,0,0,2,244,79,32,0,0,1,245,63,48,0,0,2,243,14,112,0,0,6,225,8,226,0,0,29,144,0,190,115,55,236,16,0,7,206,236,112,0,0,0,10,208,0,0,0,0,75,151,0,0,0,0,194,29,16,0,0,0,0,0,0,0,0,6,206,253,113,0,0,190,132,54,220,16,7,227,0,0,29,144,14,128,0,0,6,241,63,48,0,0,2,244,79,32,0,0,1,245,63,48,0,0,2,243,14,112,0,0,6,225,8,226,0,0,29,144,0,190,115,55,236,16,0,7,206,236,112,0,0,1,188,52,128,0,0,5,131,190,48,0,0,0,0,0,0,0,0,6,206,253,113,0,0,190,132,54,220,16,7,227,0,0,29,144,14,128,0,0,6,241,63,48,0,0,2,244,79,32,0,0,1,245,63,48,0,0,2,243,14,112,0,0,6,225,8,226,0,0,29,144,0,190,115,55,236,16,0,7,206,236,112,0,0,1,226,30,32,0,0,1,226,30,32,0,0,0,0,0,0,0,0,6,206,253,113,0,0,190,132,54,220,16,7,227,0,0,29,144,14,128,0,0,6,241,63,48,0,0,2,244,79,32,0,0,1,245,63,48,0,0,2,243,14,112,0,0,6,225,8,226,0,0,29,144,0,190,115,55,236,16,0,7,206,236,112,0,0,132,0,4,112,0,4,228,4,228,0,0,4,231,228,0,0,0,8,247,0,0,0,4,231,228,0,0,4,228,4,228,0,0,116,0,4,112,0,0,0,0,0,0,0,0,0,0,0,144,0,6,206,236,119,96,0,174,132,71,239,16,7,227,0,2,206,144,14,128,0,27,55,241,63,48,0,180,3,244,79,32,10,80,1,245,63,64,151,0,2,243,14,135,128,0,6,225,8,250,0,0,29,144,3,254,132,55,236,16,11,55,207,236,112,0,25,0,0,0,0,0,0,3,225,0,0,0,0,8,144,0,0,0,0,12,48,0,0,0,0,0,0,0,10,160,0,0,170,0,170,0,0,10,160,10,160,0,0,170,0,170,0,0,10,160,10,160,0,0,170,0,170,0,0,10,160,10,160,0,0,170,0,155,0,0,11,144,6,242,0,2,245,0,29,214,53,220,0,0,42,239,217,16,0,0,0,2,227,0,0,0,0,167,0,0,0,0,76,0,0,0,0,0,0,0,0,10,160,0,0,170,0,170,0,0,10,160,10,160,0,0,170,0,170,0,0,10,160,10,160,0,0,170,0,170,0,0,10,160,10,160,0,0,170,0,155,0,0,11,144,6,242,0,2,245,0,29,214,53,220,0,0,42,239,217,16,0,0,0,79,80,0,0,0,12,93,0,0,0,6,128,135,0,0,0,0,0,0,0,10,160,0,0,170,0,170,0,0,10,160,10,160,0,0,170,0,170,0,0,10,160,10,160,0,0,170,0,170,0,0,10,160,10,160,0,0,170,0,155,0,0,11,144,6,242,0,2,245,0,29,214,53,220,0,0,42,239,217,16,0,0,9,128,152,0,0,0,152,9,128,0,0,0,0,0,0,0,170,0,0,10,160,10,160,0,0,170,0,170,0,0,10,160,10,160,0,0,170,0,170,0,0,10,160,10,160,0,0,170,0,170,0,0,10,160,9,176,0,0,185,0,111,32,0,47,80,1,221,99,93,192,0,2,174,253,145,0,0,0,46,48,0,0,10,112,0,0,4,192,0,0,0,0,0,0,157,0,0,13,114,245,0,6,225,9,192,0,214,0,30,80,109,0,0,140,13,96,0,1,233,208,0,0,8,245,0,0,0,79,16,0,0,4,241,0,0,0,79,16,0,0,4,241,0,0,8,192,0,0,0,140,0,0,0,8,255,253,145,0,140,51,109,192,8,192,0,79,48,140,0,1,244,8,192,0,95,32,140,51,126,144,8,255,253,112,0,140,0,0,0,8,192,0,0,0,0,92,236,64,0,63,98,158,16,9,176,1,244,0,169,0,63,32,11,144,60,128,0,185,47,178,0,11,144,40,229,0,185,0,8,224,11,144,0,63,32,185,0,4,241,11,146,35,202,0,185,94,233,16,0,108,0,0,0,11,96,0,0,2,209,0,0,0,0,0,3,174,235,32,7,115,43,176,0,0,5,224,1,122,222,240,29,181,53,240,79,16,6,240,47,114,93,240,6,222,165,240,0,0,169,0,0,4,209,0,0,12,48,0,0,0,0,0,3,174,235,32,7,115,43,176,0,0,5,224,1,122,222,240,29,181,53,240,79,16,6,240,47,114,93,240,6,222,165,240,0,11,208,0,0,75,151,0,0,194,29,16,0,0,0,0,3,174,235,32,7,115,43,176,0,0,5,224,1,122,222,240,29,181,53,240,79,16,6,240,47,114,93,240,6,222,165,240,1,204,52,128,5,131,205,32,0,0,0,0,3,174,235,32,7,115,43,176,0,0,5,224,1,122,222,240,29,181,53,240,79,16,6,240,47,114,93,240,6,222,165,240,1,226,30,32,1,226,30,32,0,0,0,0,3,174,235,32,7,115,43,176,0,0,5,224,1,122,222,240,29,181,53,240,79,16,6,240,47,114,93,240,6,222,165,240,0,43,180,0,0,116,42,0,0,59,180,0,0,0,0,0,3,174,235,32,7,115,43,176,0,0,5,224,1,122,222,240,29,181,53,240,79,16,6,240,47,114,93,240,6,222,165,240,3,174,234,22,222,196,0,118,33,188,212,38,242,0,0,5,243,0,11,128,58,222,255,255,255,250,30,164,37,243,17,17,20,241,0,127,80,0,0,47,114,93,158,82,74,32,109,235,48,125,253,128,0,92,254,128,111,114,72,14,112,0,3,242,0,0,63,32,0,1,246,0,0,8,230,36,128,7,223,214,0,4,144,0,0,43,160,0,0,15,16,0,107,128,0,46,48,0,0,5,192,0,0,0,166,0,0,0,0,0,0,109,236,80,7,212,38,243,30,64,0,169,63,255,255,251,63,49,17,17,31,96,0,0,8,230,35,146,0,142,253,129,0,0,109,0,0,1,211,0,0,8,128,0,0,0,0,0,0,109,236,80,7,212,38,243,30,64,0,169,63,255,255,251,63,49,17,17,31,96,0,0,8,230,35,146,0,142,253,129,0,7,243,0,0,29,107,0,0,133,10,64,0,0,0,0,0,109,236,80,7,212,38,243,30,64,0,169,63,255,255,251,63,49,17,17,31,96,0,0,8,230,35,146,0,142,253,129,0,182,11,96,0,182,11,96,0,0,0,0,0,109,236,80,7,212,38,243,30,64,0,169,63,255,255,251,63,49,17,17,31,96,0,0,8,230,35,146,0,142,253,129,12,112,0,46,16,0,121,0,0,0,0,185,0,11,144,0,185,0,11,144,0,185,0,11,144,0,185,0,11,144,0,214,7,160,29,16,0,0,11,144,11,144,11,144,11,144,11,144,11,144,11,144,11,144,1,234,0,8,124,48,44,3,176,0,0,0,0,185,0,0,185,0,0,185,0,0,185,0,0,185,0,0,185,0,0,185,0,0,185,0,77,3,208,77,3,208,0,0,0,0,185,0,0,185,0,0,185,0,0,185,0,0,185,0,0,185,0,0,185,0,0,185,0,0,110,83,167,0,0,127,229,0,0,186,78,80,0,1,0,110,16,0,125,251,248,0,126,82,78,208,30,96,0,111,19,242,0,3,242,63,32,0,63,33,246,0,7,208,8,229,37,230,0,8,223,214,0,0,109,129,177,0,12,40,233,0,0,0,0,0,0,185,109,234,16,11,217,36,233,0,188,0,7,208,11,144,0,94,0,185,0,5,224,11,144,0,94,0,185,0,5,224,11,144,0,94,0,0,13,96,0,0,0,61,16,0,0,0,120,0,0,0,0,0,0,0,108,254,162,0,126,98,59,208,30,96,0,30,99,242,0,0,184,63,32,0,11,145,246,0,1,229,8,230,35,188,0,7,223,233,16,0,0,30,64,0,0,8,144,0,0,2,209,0,0,0,0,0,0,0,108,254,162,0,126,98,59,208,30,96,0,30,99,242,0,0,184,63,32,0,11,145,246,0,1,229,8,230,35,188,0,7,223,233,16,0,2,232,0,0,0,166,210,0,0,59,5,160,0,0,0,0,0,0,108,254,162,0,126,98,59,208,30,96,0,30,99,242,0,0,184,63,32,0,11,145,246,0,1,229,8,230,35,188,0,7,223,233,16,0,77,161,147,0,10,54,219,0,0,0,0,0,0,6,207,234,32,7,230,35,189,1,230,0,1,230,63,32,0,11,131,242,0,0,185,31,96,0,30,80,142,98,59,192,0,125,254,145,0,0,107,6,176,0,6,176,107,0,0,0,0,0,0,6,207,234,32,7,230,35,189,1,230,0,1,230,63,32,0,11,131,242,0,0,185,31,96,0,30,80,142,98,59,192,0,125,254,145,0,0,0,46,48,0,0,0,2,226,0,0,0,0,0,0,0,0,0,0,0,0,0,3,255,255,255,242,0,1,17,17,17,0,0,0,0,0,0,0,0,2,227,0,0,0,0,46,32,0,0,0,0,0,0,160,0,108,254,170,112,7,230,35,223,16,30,96,7,190,96,63,32,107,27,144,63,38,193,11,144,30,172,16,30,80,9,247,35,188,0,29,124,254,145,0,85,0,0,0,0,0,62,32,0,0,0,138,0,0,0,0,195,0,0,0,0,0,0,13,96,0,140,0,214,0,8,192,13,96,0,140,0,214,0,8,192,13,96,0,140,0,200,0,11,192,8,229,39,236,0,25,238,136,192,0,0,30,48,0,0,9,128,0,0,3,192,0,0,0,0,0,0,13,96,0,140,0,214,0,8,192,13,96,0,140,0,214,0,8,192,13,96,0,140,0,200,0,11,192,8,229,39,236,0,25,238,136,192,0,5,244,0,0,0,197,192,0,0,119,9,96,0,0,0,0,0,13,96,0,140,0,214,0,8,192,13,96,0,140,0,214,0,8,192,13,96,0,140,0,200,0,11,192,8,229,39,236,0,25,238,136,192,0,153,8,144,0,9,144,137,0,0,0,0,0,0,214,0,8,192,13,96,0,140,0,214,0,8,192,13,96,0,140,0,214,0,8,192,12,128,0,188,0,142,82,126,192,1,158,232,140,0,0,0,169,0,0,3,209,0,0,12,64,0,0,0,0,0,186,0,0,215,95,16,3,241,14,80,8,160,8,160,13,64,2,241,61,0,0,181,151,0,0,90,210,0,0,14,160,0,0,14,64,0,0,93,0,0,3,214,0,0,158,128,0,0,11,144,0,0,0,185,0,0,0,11,144,0,0,0,185,0,0,0,11,150,223,196,0,189,163,42,225,11,208,0,13,112,185,0,0,185,11,144,0,11,128,188,0,1,229,11,232,35,189,0,185,142,234,32,11,144,0,0,0,185,0,0,0,11,144,0,0,0,185,0,0,0,3,209,61,16,3,209,61,16,0,0,0,0,186,0,0,215,95,16,3,241,14,80,8,160,8,160,13,64,2,241,61,0,0,181,151,0,0,90,210,0,0,14,160,0,0,14,64,0,0,93,0,0,3,214,0,0,158,128,0,0
};
static const StrandGlyph StrandBodyGlyphs[] PROGMEM={
{0,4,0,4,0,0},
{0,5,11,5,0,-11},
{28,6,11,6,0,-11},
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{11056,8,15,8,0,-11}
};
const StrandFont StrandBody={StrandBodyBits,StrandBodyGlyphs,19};
