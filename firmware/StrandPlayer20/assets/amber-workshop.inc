// Native 314x138 RGB565 artwork, rendered from the approved mockup asset.
static const uint16_t Art7[] PROGMEM={
0x7ac6,0x8b07,0x82c6,0x82c6,0x82c6,0x82c6,0x9307,0x49a4,0x5183,0x3102,0x4183,0x8ae6,0x82c6,0x8ae7,0x3122,0x5a04,0x5a04,0x4163,0x8ae6,0x82a6,0x82a6,0x7aa6,0x82a6,0x82a6,
0x82c6,0x7a86,0x1081,0x6204,0x82a5,0x7265,0x6a24,0x6a04,0x20c1,0x0840,0x3102,0x3122,0x20e2,0x18e2,0x10e3,0x5121,0x6981,0x5a87,0x9b87,0xd5ef,0x940a,0x7b69,0x62a7,0x41c5,
0x3163,0x3143,0x3163,0x3983,0x39a3,0x39a3,0x41c3,0x41e4,0x41c3,0x39a3,0x3143,0x2903,0x20e2,0x28e2,0x28e1,0x48e1,0x6921,0x7121,0x7901,0x60e1,0x6101,0x6122,0x6122,0x5122,
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0x28e2,0x0841,0x0841,0x0841,0x0840,0x0040,0x20a2,0x3923,0x3923,0x3923,0x3923,0x3944,
};
