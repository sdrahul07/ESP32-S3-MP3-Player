// Native 314x138 RGB565 artwork, rendered from the approved mockup asset.
static const uint16_t Art4[] PROGMEM={
0xf7ba,0xfffc,0xf7ba,0xf7ba,0xf7ba,0xf7ba,0xf7da,0xf7ba,0xf7ba,0xf7ba,0xf7ba,0xf7ba,0xf7ba,0xf7ba,0xf7ba,0xf7ba,0xf7ba,0xf7ba,0xf7ba,0xf7ba,0xf7ba,0xf7ba,0xf7ba,0xf7ba,
0xf7ba,0xf7ba,0xf7ba,0xf7ba,0xf7ba,0xf7ba,0xf7ba,0xf7ba,0xf7ba,0xf7ba,0xf7ba,0xf7ba,0xf7ba,0xf7ba,0xf7ba,0xf7da,0xf7ba,0xf7ba,0xf7ba,0xf7ba,0xf7ba,0xf7ba,0xf7ba,0xf7ba,
0xf7ba,0xf7ba,0xf7ba,0xf7ba,0xf7ba,0xf7ba,0xf7ba,0xf7ba,0xf7ba,0xf7ba,0xf7ba,0xf7ba,0xf7ba,0xf7ba,0xf7ba,0xf7ba,0xf7ba,0xf7ba,0xf7ba,0xf7ba,0xf7ba,0xf7ba,0xf7ba,0xf7ba,
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0xfffc,0xfffc,0xfffc,0xfffc,0xfffc,0xfffc,0xfffc,0xfffc,0xfffc,0xfffc,0xfffc,0xffff,
};
