// Native 314x138 RGB565 artwork, rendered from the approved mockup asset.
static const uint16_t Art6[] PROGMEM={
0x0948,0x0127,0x08a4,0x08a4,0x08a4,0x08e6,0x0989,0x09ca,0x09ca,0x0947,0x00a4,0x0948,0x0989,0x136c,0x09e8,0x08e6,0x0189,0x2bac,0x64cb,0x00c5,0x0884,0x0989,0x09ea,0x0989,
0x08a4,0x0084,0x00a4,0x08e6,0x0927,0x0948,0x00c6,0x0a8a,0x09a8,0x0023,0x09e8,0x1b2b,0x19c6,0x0927,0x09ea,0x08a4,0x08a4,0x08a4,0x0083,0x08e5,0x1269,0x0946,0x0989,0x0a4d,
0x0a0c,0x134a,0x09e7,0x0043,0x08c5,0x08a4,0x0863,0x01aa,0x0a2c,0x0a4c,0x0a0b,0x08e6,0x0a0b,0x0a2b,0x0a49,0x0a6b,0x12ac,0x09a8,0x0927,0x00c5,0x1ac8,0x09c7,0x0084,0x09a8,
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0x118b,0x0907,0x0883,0x08a4,0x08a4,0x08a4,0x08a4,0x08a4,0x08a4,0x08a4,0x08a4,0x08a4,
};
