// Native 314x138 RGB565 artwork, rendered from the approved mockup asset.
static const uint16_t Art5[] PROGMEM={
0x9372,0xa3b3,0x9b92,0x9b92,0x9b92,0x9b92,0x9b72,0x5a0b,0x8b11,0x9352,0xabf3,0xd5f5,0x51ea,0x8b12,0xbcd4,0xff17,0xfeb6,0xff18,0x41e7,0x312b,0x520f,0x49ee,0x49ee,0x49ee,
0x49ee,0x49ee,0x4a0f,0x49ee,0x49ee,0x49ef,0x4a0f,0x49ee,0x49ee,0x49ef,0x49ef,0x4a0f,0x4a0f,0x4a0f,0x49ef,0x49ef,0x49ef,0x4a0f,0x49ee,0x49ee,0x4a0e,0x4a0e,0x4a0e,0x4a0f,
0x4a0f,0x4a0f,0x4a0f,0x520f,0x520f,0x4a0f,0x520f,0x520f,0x4a0f,0x4a0f,0x520f,0x4a0f,0x49ee,0x49ee,0x49ee,0x49ee,0x49ee,0x49ee,0x49ef,0x49ee,0x49ee,0x49ee,0x49ef,0x49ee,
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0x3928,0x3929,0x3929,0x3928,0x498b,0x6a30,0x620e,0x416a,0x416a,0x416a,0x416a,0x498b,
};
