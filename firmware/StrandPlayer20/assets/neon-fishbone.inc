// Native 314x138 RGB565 artwork, rendered from the approved mockup asset.
static const uint16_t Art0[] PROGMEM={
0xffbc,0xfffe,0xffbc,0xffbc,0xffbc,0xffbc,0xffbc,0xffbc,0xffbc,0xffbc,0xffbc,0xffbc,0xffbc,0xffbc,0xffbc,0xffbc,0xffbc,0xffbc,0xffbc,0xffbc,0xffbc,0xffbc,0xffbc,0xffbc,
0xffbc,0xffbc,0xffbc,0xffbc,0xffbc,0xffbc,0xffbc,0xffbc,0xffbc,0xffbc,0xffbc,0xffbc,0xffbc,0xffbc,0xffbc,0xffbc,0xffbc,0xffbc,0xffbc,0xffbc,0xffbc,0xffbc,0xffbc,0xffbc,
0xffbc,0xffbc,0xffbc,0xffbc,0xffbc,0xffbc,0xffbc,0xffbc,0xffbc,0xffbc,0xffbc,0xffbc,0xffbc,0xffbc,0xffbc,0xffbc,0xffbc,0xffbc,0xffbc,0xffbc,0xffbc,0xffbc,0xffbc,0xffbc,
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0xfffe,0xfffe,0xfffe,0xfffe,0xfffe,0xfffe,0xfffe,0xfffe,0xfffe,0xfffe,0xfffe,0xffff,
};
