// Native 314x138 RGB565 artwork, rendered from the approved mockup asset.
static const uint16_t Art8[] PROGMEM={
0x0040,0x0040,0x0021,0x0021,0x0021,0x0021,0x0040,0x41e7,0x73cd,0x5b0a,0x41e7,0x0040,0x0040,0x0040,0x0021,0x0021,0x0021,0x0021,0x0040,0x41e7,0x41e7,0x0040,0x0021,0x0021,
0x0021,0x0021,0x39c6,0x39c6,0x4a87,0x4a87,0x4246,0x41e7,0x41e7,0x41e7,0x41e7,0x41e7,0x634b,0x634b,0x94d1,0x94d1,0x94d1,0x0040,0x0040,0x41e7,0x41e7,0x2103,0x2103,0x0040,
0x0040,0x0040,0x0040,0x2983,0x41e7,0x2983,0x73cd,0x4a87,0x4a87,0x4a87,0x4a87,0x4a87,0x4a87,0x4a87,0x4a87,0x4a87,0x4a87,0x4a87,0x4a87,0x4a87,0x4a87,0x73cd,0x2983,0x3a05,
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0x4a87,0x5b0a,0x5b0a,0x5b0a,0x5b0a,0x5b0a,0x73cd,0x0040,0x0040,0x0040,0x0040,0x0040,
};
