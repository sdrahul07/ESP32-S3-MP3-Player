// Native 314x138 RGB565 artwork, rendered from the approved mockup asset.
static const uint16_t Art3[] PROGMEM={
0xf799,0xfffb,0xf779,0xf799,0xf799,0xf779,0xf799,0xf779,0xf799,0xf779,0xf779,0xf799,0xf799,0xf799,0xf799,0xf799,0xf779,0xf779,0xf779,0xf799,0xf799,0xf799,0xf799,0xf799,
0xf799,0xf799,0xf799,0xf799,0xf799,0xf799,0xf799,0xf799,0xf799,0xf799,0xf779,0xf779,0xf799,0xf799,0xf799,0xf799,0xf799,0xf779,0xf779,0xf779,0xf779,0xf779,0xf799,0xf779,
0xf779,0xf779,0xf799,0xf779,0xf799,0xf799,0xf799,0xf799,0xf799,0xf779,0xf799,0xf779,0xf799,0xf779,0xf779,0xf779,0xf779,0xf779,0xf779,0xf779,0xf779,0xf779,0xf779,0xf779,
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0xfffb,0xfffb,0xfffb,0xfffb,0xfffb,0xfffb,0xfffb,0xfffb,0xfffb,0xfffb,0xfffb,0xfffd,
};
