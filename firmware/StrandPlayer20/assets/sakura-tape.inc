// Native 314x138 RGB565 artwork, rendered from the approved mockup asset.
static const uint16_t Art1[] PROGMEM={
0xf98b,0xf98c,0xf98b,0xf98b,0xf98b,0xf96b,0xf9aa,0xfd62,0xfe00,0xfdc1,0xfdc1,0xfdc1,0xfdc1,0xedc2,0x6da7,0x65c7,0x65c7,0x65c7,0x6dc6,0x55aa,0x04da,0x04fb,0x04fa,0x04fa,
0x04da,0x14fa,0xff38,0xff18,0xff38,0xff7a,0xcdb4,0x93cd,0xff9a,0xf718,0xff18,0xff18,0xff39,0xeed8,0x836c,0xff39,0xff39,0xff19,0xff19,0xff39,0xff7a,0x838d,0xde36,0xff59,
0xff18,0xff19,0xff19,0xff5a,0x9e92,0x2daa,0x3dcb,0x3dcb,0x3dcb,0x3dcb,0x3dcc,0x3dcc,0x3dcc,0x3dcb,0x3dcb,0x3dcb,0x3dcb,0x3dcb,0x3dcb,0x3dcb,0x3dcb,0x3dcb,0x3dcb,0x3dcb,
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0x3e4c,0x3e4c,0x3e4c,0x3e4c,0x3e4c,0x3e2c,0x3e2c,0x3e2c,0x3e2c,0x3e2c,0x3e2c,0x46cd,
};
